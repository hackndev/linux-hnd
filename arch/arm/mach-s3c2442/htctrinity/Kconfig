## arch/arm/mach-s3c2442/htctrinity/Kconfig
```kconfig
config MACH_HTC_TRINITY
	bool "HTC Trinity"
	select CPU_S3C2440
	select CPU_S3C2442
	help
	  Say Y here if you are using the HTC Trinity.

	  See <http://wiki.xda-developers.com/index.php?pagename=Hermes_Linux> for more
	  information on this project

config HTCTRINITY_LCD
	tristate "HTC Trinity VSFB LCD support"
	depends on MACH_HTC_TRINITY && LCD_CLASS_DEVICE
	help
	  This driver provides support for HTC Trinity LCD display.
```

## drivers/input/touchscreen/Kconfig
```kconfig
#
# Touchscreen driver configuration
#
menuconfig INPUT_TOUCHSCREEN
	bool "Touchscreens"
	help
	  Say Y here, and a list of supported touchscreens will be displayed.
	  This option doesn't affect the kernel.

	  If unsure, say Y.

if INPUT_TOUCHSCREEN

config TOUCHSCREEN_ADS7846
	tristate "ADS 7846/7843 based touchscreens"
	depends on SPI_MASTER
	depends on HWMON = n || HWMON
	help
	  Say Y here if you have a touchscreen interface using the
	  ADS7846 or ADS7843 controller, and your board-specific setup
	  code includes that in its table of SPI devices.

	  If HWMON is selected, and the driver is told the reference voltage
	  on your board, you will also get hwmon interfaces for the voltage
	  (and on ads7846, temperature) sensors of this chip.

	  If unsure, say N (but it's safe to say "Y").

	  To compile this driver as a module, choose M here: the
	  module will be called ads7846.

config TOUCHSCREEN_BITSY
	tristate "Compaq iPAQ H3600 (Bitsy) touchscreen"
	depends on SA1100_BITSY
	select SERIO
	help
	  Say Y here if you have the h3600 (Bitsy) touchscreen.

	  If unsure, say N.

	  To compile this driver as a module, choose M here: the
	  module will be called h3600_ts_input.

config TOUCHSCREEN_CORGI
	tristate "SharpSL (Corgi and Spitz series) touchscreen driver"
	depends on PXA_SHARPSL
	default y	
	help
	  Say Y here to enable the driver for the touchscreen on the 
	  Sharp SL-C7xx and SL-Cxx00 series of PDAs.

	  If unsure, say N.

	  To compile this driver as a module, choose M here: the
	  module will be called corgi_ts.

config TOUCHSCREEN_TSC2101
	tristate "TI TSC2101 touchscreen input driver"
	depends on (MACH_HX2750 || MACH_T3XSCALE) && INPUT_TOUCHSCREEN && SOC_TSC2101
	default y
	help
	  Say Y here to enable the driver for the touchscreen on the 
	  iPAQ hx2750 series of PDAs or Palm Tungsten|T3.

	  If unsure, say N.

	  To compile this driver as a module, choose M here: the
	  module will be called tsc2101_ts.

config TOUCHSCREEN_GUNZE
	tristate "Gunze AHL-51S touchscreen"
	select SERIO
	help
	  Say Y here if you have the Gunze AHL-51 touchscreen connected to
	  your system.

	  If unsure, say N.

	  To compile this driver as a module, choose M here: the
	  module will be called gunze.

config TOUCHSCREEN_ELO
	tristate "Elo serial touchscreens"
	select SERIO
	help
	  Say Y here if you have an Elo serial touchscreen connected to
	  your system.

	  If unsure, say N.

	  To compile this driver as a module, choose M here: the
	  module will be called elo.

config TOUCHSCREEN_MTOUCH
	tristate "MicroTouch serial touchscreens"
	select SERIO
	help
	  Say Y here if you have a MicroTouch (3M) serial touchscreen connected to
	  your system.

	  If unsure, say N.

	  To compile this driver as a module, choose M here: the
	  module will be called mtouch.

config TOUCHSCREEN_MK712
	tristate "ICS MicroClock MK712 touchscreen"
	help
	  Say Y here if you have the ICS MicroClock MK712 touchscreen
	  controller chip in your system.

	  If unsure, say N.

	  To compile this driver as a module, choose M here: the
	  module will be called mk712.

config TOUCHSCREEN_HP600
	tristate "HP Jornada 680/690 touchscreen"
	depends on SH_HP6XX && SH_ADC
	help
	  Say Y here if you have a HP Jornada 680 or 690 and want to
          support the built-in touchscreen.

	  If unsure, say N.

	  To compile this driver as a module, choose M here: the
	  module will be called hp680_ts_input.

config TOUCHSCREEN_PENMOUNT
	tristate "Penmount serial touchscreen"
	select SERIO
	help
	  Say Y here if you have a Penmount serial touchscreen connected to
	  your system.

	  If unsure, say N.

	  To compile this driver as a module, choose M here: the
	  module will be called penmount.

config TOUCHSCREEN_TOUCHRIGHT
	tristate "Touchright serial touchscreen"
	select SERIO
	help
	  Say Y here if you have a Touchright serial touchscreen connected to
	  your system.

	  If unsure, say N.

	  To compile this driver as a module, choose M here: the
	  module will be called touchright.

config TOUCHSCREEN_TOUCHWIN
	tristate "Touchwin serial touchscreen"
	select SERIO
	help
	  Say Y here if you have a Touchwin serial touchscreen connected to
	  your system.

	  If unsure, say N.

	  To compile this driver as a module, choose M here: the
	  module will be called touchwin.

config TOUCHSCREEN_S3C2410
	tristate "Samsung S3C2410 touchscreen input driver"
	depends on ARCH_S3C2410 && INPUT && INPUT_TOUCHSCREEN
	select SERIO
	help
	  Say Y here if you have the s3c2410 touchscreen.

	  If unsure, say N.

	  To compile this driver as a module, choose M here: the
	  module will be called s3c2410_ts.

config TOUCHSCREEN_S3C2410_DEBUG
	boolean "Samsung S3C2410 touchscreen debug messages"
	depends on TOUCHSCREEN_S3C2410
	help
	  Select this if you want debug messages

config TOUCHSCREEN_S3C2410_ALT
	boolean "Alternate ADC conversion management"
	depends on TOUCHSCREEN_S3C2410
	help
	  Select this if you have some glitches with the standard
	  driver. This alternate ADC management has been implemented
	  for the s3c2440 G500. On this machine the other driver is
	   not smooth, there are annoying glitches that prevent the
	   stylus to be usable.

config TOUCHSCREEN_ASIC2
	tristate "HTC ASIC2 Touchscreen driver"
	depends on HTC_ASIC2
	select ADC_ASIC2
	help
	  Touchscreen driver for ASIC2 chip. This will pull in 
	  dependent ASIC2 ADC driver automatically.

config TOUCHSCREEN_IPAQ_MICRO
        tristate "HP iPAQ Micro ASIC - touchscreen driver"
        depends on IPAQ_MICRO && INPUT

config TOUCHSCREEN_TSC2200
        tristate "TSC2200 touchscreen driver"
        depends on SOC_TSC2200

config TOUCHSCREEN_ADC
        tristate "Touchscreen driver for Generic ADC device"
	depends on ADC
	help
	  Touchscreen driver which uses Generic ADC API
	  (linux/adc.h) to sample TS coordinates. Fully
	  configurable via platform_data. Includes optional
	  software debouncing.

	  To compile this driver as a module, choose M here: the
	  module will be called ts_adc.

config TOUCHSCREEN_UCB1400
	tristate "Philips UCB1400 touchscreen"
	select AC97_BUS
	help
	  This enables support for the Philips UCB1400 touchscreen interface.
	  The UCB1400 is an AC97 audio codec.  The touchscreen interface
	  will be initialized only after the ALSA subsystem has been
	  brought up and the UCB1400 detected.  You therefore have to
	  configure ALSA support as well (either built-in or modular,
	  independently of whether this driver is itself built-in or
	  modular) for this driver to work.

	  To compile this driver as a module, choose M here: the
	  module will be called ucb1400_ts.

config TOUCHSCREEN_PALMTC
	tristate "Palm Tungsten|C UCB1400 touchscreen"
	select AC97_BUS
	help
	  This enables support for the Philips UCB1400 touchscreen interface.
	  The UCB1400 is an AC97 audio codec.  The touchscreen interface
	  will be initialized only after the ALSA subsystem has been
	  brought up and the UCB1400 detected.  You therefore have to
	  configure ALSA support as well (either built-in or modular,
	  independently of whether this driver is itself built-in or
	  modular) for this driver to work.

	  To compile this driver as a module, choose M here: the
	  module will be called palmtc_ts.

config TOUCHSCREEN_WM97XX
	tristate "Support for WM97xx AC97 touchscreen controllers"
	depends AC97_BUS
	
if TOUCHSCREEN_WM97XX
choice
	prompt "WM97xx codec type"
	depends TOUCHSCREEN_WM97XX
config TOUCHSCREEN_WM9705
	bool "WM9705 Touchscreen interface support"
	depends on TOUCHSCREEN_WM97XX 
	help
	  Say Y here if you have the wm9705/12 touchscreen.

	  If unsure, say N.

	  To compile this driver as a module, choose M here: the
	  module will be called wm9705.
	  
config TOUCHSCREEN_WM9712
	bool "WM9712 Touchscreen interface support"
	depends on TOUCHSCREEN_WM97XX 
	help
	  Say Y here if you have the wm9712 touchscreen.

	  If unsure, say N.

	  To compile this driver as a module, choose M here: the
	  module will be called wm9712.
	  
config TOUCHSCREEN_WM9713
	bool "WM9713 Touchscreen interface support"
	depends on TOUCHSCREEN_WM97XX 
	help
	  Say Y here if you have the wm9713 touchscreen.

	  If unsure, say N.

	  To compile this driver as a module, choose M here: the
	  module will be called wm9713.
	  
endchoice

config TOUCHSCREEN_WM97XX_PXA
	bool "WM97xx PXA accelerated touch"
	depends on TOUCHSCREEN_WM97XX && ARCH_PXA
	select TOUCHSCREEN_WM97XX_ACC
	help
	  Say Y here for continuous mode touch on the PXA

	  If unsure, say N

	  To compile this driver as a module, choose M here: the
	  module will be called pxa-wm97xx
	  
config TOUCHSCREEN_WM97XX_ACC
	bool
	help
	  Enable support for WM97xx accelerated touchscreens
endif	  
endif
```
