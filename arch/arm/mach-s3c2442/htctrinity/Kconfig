## drivers/leds/Kconfig
```kconfig
menu "LED devices"

config NEW_LEDS
	bool "LED Support"
	help
	  Say Y to enable Linux LED support.  This allows control of supported
	  LEDs from both userspace and optionally, by kernel events (triggers).

	  This is not related to standard keyboard LEDs which are controlled
	  via the input system.

config LEDS_CLASS
	tristate "LED Class Support"
	depends on NEW_LEDS
	help
	  This option enables the led sysfs class in /sys/class/leds.  You'll
	  need this to do anything useful with LEDs.  If unsure, say N.

comment "LED drivers"

config LEDS_CORGI
	tristate "LED Support for the Sharp SL-C7x0 series"
	depends on LEDS_CLASS && PXA_SHARP_C7xx
	help
	  This option enables support for the LEDs on Sharp Zaurus
	  SL-C7x0 series (C700, C750, C760, C860).

config LEDS_LOCOMO
	tristate "LED Support for Locomo device"
	depends on LEDS_CLASS && SHARP_LOCOMO
	help
	  This option enables support for the LEDs on Sharp Locomo.
	  Zaurus models SL-5500 and SL-5600.

config LEDS_SPITZ
	tristate "LED Support for the Sharp SL-Cxx00 series"
	depends on LEDS_CLASS && PXA_SHARP_Cxx00
	help
	  This option enables support for the LEDs on Sharp Zaurus
	  SL-Cxx00 series (C1000, C3000, C3100).

config LEDS_IXP4XX
	tristate "LED Support for GPIO connected LEDs on IXP4XX processors"
	depends on LEDS_CLASS && ARCH_IXP4XX
	help
	  This option enables support for the LEDs connected to GPIO
	  outputs of the Intel IXP4XX processors.  To be useful the
	  particular board must have LEDs and they must be connected
	  to the GPIO lines.  If unsure, say Y.

config LEDS_TOSA
	tristate "LED Support for the Sharp SL-6000 series"
	depends on LEDS_CLASS && PXA_SHARPSL
	help
	  This option enables support for the LEDs on Sharp Zaurus
	  SL-6000 series.

config LEDS_S3C24XX
	tristate "LED Support for Samsung S3C24XX GPIO LEDs"
	depends on LEDS_CLASS && ARCH_S3C2410
	help
	  This option enables support for LEDs connected to GPIO lines
	  on Samsung S3C24XX series CPUs, such as the S3C2410 and S3C2440.

config LEDS_MAGICIAN
	tristate "LED Support for the HTC Magician"
	depends LEDS_CLASS && MACH_MAGICIAN && HTC_EGPIO
	help
	  This option enables support for the LEDs connected to the
	  AIC3 MA17635 0450 v1.1 MPU Timing Generator.

config LEDS_AMS_DELTA
	tristate "LED Support for the Amstrad Delta (E3)"
	depends on LEDS_CLASS && MACH_AMS_DELTA
	help
	  This option enables support for the LEDs on Amstrad Delta (E3).

config LEDS_NET48XX
	tristate "LED Support for Soekris net48xx series Error LED"
	depends on LEDS_CLASS && SCx200_GPIO
	help
	  This option enables support for the Soekris net4801 and net4826 error
	  LED.

config LEDS_ASIC3
	tristate "LED Support for the HTC ASIC3 chip"
	depends LEDS_CLASS && HTC_ASIC3
	help
	  This option enables support for the LEDs connected to the
	  HTC ASIC3 chip.

config LEDS_PASIC3
	tristate "LED Support for the HTC PASIC3 chip"
	depends LEDS_CLASS && HTC_PASIC3
	help
	  This option enables support for the LEDs connected to the
	  HTC PASIC3 chip.

config LEDS_SAMCOP
	tristate "LED Support for the Samsung's SAMCOP chip"
	depends LEDS_CLASS && SOC_SAMCOP
	help
	  This option enables support for the LEDs connected to the
	  Samsung's SAMCOP chip.

config LEDS_HAMCOP
	tristate "LED Support for the Samsung's HAMCOP chip"
	depends LEDS_CLASS && SOC_HAMCOP
	help
	  This option enables support for the LEDs connected to the
	  Samsung's HAMCOP chip.

config LEDS_WRAP
	tristate "LED Support for the WRAP series LEDs"
	depends on LEDS_CLASS && SCx200_GPIO
	help
	  This option enables support for the PCEngines WRAP programmable LEDs.

config LEDS_MAGICIAN
	tristate "LED Support for the HTC Magician"
	depends LEDS_CLASS && MACH_MAGICIAN && MAGICIAN_CPLD
	help
	  This option enables support for the LEDs connected to the
	  AIC3 MA17635 0450 v1.1 MPU Timing Generator.

config LEDS_PALMLD
	tristate "LED Support for Palm LifeDrive"
	depends LEDS_CLASS && MACH_XSCALE_PALMLD
	help
	  This option enables support for the LEDs on Palm LifeDrive.

config LEDS_PALMTT3
	tristate "LED Support for Palm Tungsten|T3"
	depends LEDS_CLASS && MACH_T3XSCALE && TPS65010
	help
	  This option enables support for the LEDs on Palm Tungsten|T3.

config LEDS_PALMZ72
	tristate "LED Support for PalmOne Zire 72"
	depends LEDS_CLASS && MACH_PALMZ72
	help
	  This option enables support for the LED on PalmOne Zire72.

config LEDS_PALMT650
	tristate "LED Support for Palm Treo 650"
	depends LEDS_CLASS && MACH_XSCALE_PALMTREO650
	help
	  This option enables support for the LEDs on Palm Treo 650.

config LEDS_H1940
	tristate "LED Support for iPAQ H1940 device"
	depends LEDS_CLASS && ARCH_H1940
	help
	  This option enables support for the LEDs on the h1940.

config LEDS_COBALT
	tristate "LED Support for Cobalt Server front LED"
	depends on LEDS_CLASS && MIPS_COBALT
	help
	  This option enables support for the front LED on Cobalt Server

config LEDS_GHI270
	tristate "LED Support for the Grayhill GHI270 series devices"
	depends on LEDS_CLASS && MACH_GHI270
	help
	  This option enables support for the LEDs on Grayhill GHI270 devices.

comment "LED Triggers"

config LEDS_TRIGGERS
	bool "LED Trigger support"
	depends on NEW_LEDS
	help
	  This option enables trigger support for the leds class.
	  These triggers allow kernel events to drive the LEDs and can
	  be configured via sysfs. If unsure, say Y.

config LEDS_TRIGGER_TIMER
	tristate "LED Timer Trigger"
	depends on LEDS_TRIGGERS
	help
	  This allows LEDs to be controlled by a programmable timer
	  via sysfs. If unsure, say Y.

config LEDS_TRIGGER_HWTIMER
	tristate "LED Hardware Timer Trigger"
	depends LEDS_TRIGGERS
	help
	  This allows LEDs to be controlled by a programmable hardware
	  timer via sysfs. If unsure, say Y.

config LEDS_TRIGGER_IDE_DISK
	bool "LED IDE Disk Trigger"
	depends on LEDS_TRIGGERS && BLK_DEV_IDEDISK
	help
	  This allows LEDs to be controlled by IDE disk activity.
	  If unsure, say Y.

config LEDS_TRIGGER_MMC_CARD
	bool "LED MMC Card Trigger"
	depends LEDS_TRIGGERS 
	help
	  This allows LEDs to be controlled by MMC card activity on Intel PXA 25x/26x/27x MMC interface .
	  If unsure, say Y.

config LEDS_TRIGGER_BACKLIGHT
	bool "LED Backlight Trigger"
	depends on BACKLIGHT_CLASS_DEVICE
	help
	  This allows LEDs to be controlled by backlight brightness.
	  If unsure, say N.

config LEDS_TRIGGER_HEARTBEAT
	tristate "LED Heartbeat Trigger"
	depends on LEDS_TRIGGERS
	help
	  This allows LEDs to be controlled by a CPU load average.
	  The flash frequency is a hyperbolic function of the 1-minute
	  load average.
	  If unsure, say Y.

config LEDS_TRIGGER_SHARED
	bool "Shared LEDs trigger"
	depends LEDS_TRIGGERS
	help
	  Trigger for the LEDs which are shared between devices.
	  If unsure, say Y.

endmenu
```

## drivers/mfd/Kconfig
```kconfig
#
# Multifunction miscellaneous devices
#

menu "Multifunction device drivers"

config MFD_SM501
	tristate "Support for Silicon Motion SM501"
	 ---help---
	  This is the core driver for the Silicon Motion SM501 multimedia
	  companion chip. This device is a multifunction device which may
	  provide numerous interfaces including USB host controller USB gadget,
	  Asyncronous Serial ports, Audio functions and a dual display video
	  interface. The device may be connected by PCI or local bus with
	  varying functions enabled.

config IPAQ_MICRO
	tristate "Atmel Micro ASIC (iPAQ h3600) Support"
	depends on SA1100_H3600

config HTC_ASIC2
	tristate "HTC ASIC2 (iPAQ h3800/h3900) SoC support"

config HTC_ASIC3
	tristate "HTC ASIC3 (iPAQ h1900/h3900/h4000/hx4700/rx3000) support"

config HTC_PASIC3
	tristate "HTC PASIC3 (HTC Blueangel/Magician) support"

config HTC_EGPIO
	tristate "HTC EGPIO support"
	help
	    This driver supports the CPLD egpio chip present on
	    several HTC phones.  It provides basic support for input
	    pins, output pins, and irqs.

config HTC_ASIC3_DS1WM
	bool "Support HTC ASIC3 builtin DS1WM block"
	help
	    Choose Y here if you want to include support for ASIC3's builtin
	    W1 controller. Some devices do not use it, and yet other have
	    separate DS1WM controller. For them, choose N.

config SOC_SAMCOP
	tristate "Samsung SAMCOP/S3CA400A01 (iPAQ h5000) driver"

config SOC_HAMCOP
	tristate "Samsung HAMCOP/S3CA410X01 (iPAQ h2200) driver"
	select DMABOUNCE

config SOC_SAMCOP_DMA
	tristate "Samsung SAMCOP/HAMCOP DMA driver"
	depends on (SOC_SAMCOP || SOC_HAMCOP)

config SOC_SAMCOP_DMA_DEBUG
	bool "Samsung SAMCOP/HAMCOP DMA debugging"
	depends on SOC_SAMCOP_DMA

config SOC_MQ11XX
	tristate "MediaQ 1100/32/68/78/88 SoC support"
	---help---
	  MediaQ 1100/32/68/78/88 are system-on-chips that implement a
	  graphics engine, flat panel controller, USB function controller,
	  OHCI-compliant USB host controller (1132 only), I2S and SPI
	  controllers (also 1132 only).

	  This driver implements only the basic support for MediaQ chips;
	  after you select this option the subdevice drivers will appear
	  in the respective submenus: MediaQ 1100/32/68/78/88 framebuffer
	  support, Dell Axim X5 LCD support and so on.

	  To compile this driver as a module, choose M here: the
	  module will be called mq11xx_base.o.

config SOC_T7L66XB
	bool "Toshiba T7L66XB SoC support"
	depends on ARCH_PXA
	---help---
	  This driver supports the T7L66XB, which incorporates SD/MMC, and
	  USB host functionality. associated subdevices are:
	      tmio_mmc
	      tmio_ohci

	  To compile this driver as a module, choose M here: the
	  module will be called t7l66xb.ko. 

config SOC_TC6387XB
	bool "Toshiba TC6387XB SoC support"
	---help---
	  This driver supports the TC6393XB, which incorporates SD/MMC, NAND,
	  Video, and USB host functionality. associated subdevices are:
	      tmio_mmc

config SOC_TC6393XB
	bool "Toshiba TC6393XB SoC support"
	depends on ARCH_PXA
	---help---
	  This driver supports the TC6393XB, which incorporates SD/MMC, NAND,
	  Video, and USB host functionality. associated subdevices are:
	      tmio_mmc
	      tmio_nand
	      tmio_fb
	      tmio_ohci

	  To compile this driver as a module, choose M here: the
	  module will be called t7l66xb.ko.

config SOC_TSC2101
	tristate "Support for TI TSC2101 Touchscreen and Audio Codec"
	depends TOUCHSCREEN_TSC2101 && SOUND && SND && SND_PXA2xx_I2SOUND
#	depends TOUCHSCREEN_TSC2101
#	select SND_PXA2xx_I2SOUND
	default m
	help
	  Support for TI TSC2101 Touchscreen and Audio Codec

config SOC_TSC2200
	tristate "Support for TI TSC2200 Touchscreen, Battery and Keypad"
	help
	  Support for TI TSC2200 Touchscreen, Battery and Keypad
endmenu

menu "Multimedia Capabilities Port drivers"
	depends on ARCH_SA1100

config MCP
	tristate

# Interface drivers
config MCP_SA11X0
	tristate "Support SA11x0 MCP interface"
	depends on ARCH_SA1100
	select MCP

# Chip drivers
config MCP_UCB1200
	tristate "Support for UCB1200 / UCB1300"
	depends on MCP

config MCP_UCB1200_TS
	tristate "Touchscreen interface support"
	depends on MCP_UCB1200 && INPUT

endmenu
```
