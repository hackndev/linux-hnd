## drivers/misc/Kconfig
```kconfig
#
# Misc strange devices
#

menu "Misc devices"

config IBM_ASM
	tristate "Device driver for IBM RSA service processor"
	depends on X86 && PCI && EXPERIMENTAL
	---help---
	  This option enables device driver support for in-band access to the
	  IBM RSA (Condor) service processor in eServer xSeries systems.
	  The ibmasm device driver allows user space application to access
	  ASM (Advanced Systems Management) functions on the service
	  processor. The driver is meant to be used in conjunction with
	  a user space API.
	  The ibmasm driver also enables the OS to use the UART on the
	  service processor board as a regular serial port. To make use of
	  this feature serial driver support (CONFIG_SERIAL_8250) must be
	  enabled.

	  WARNING: This software may not be supported or function
	  correctly on your IBM server. Please consult the IBM ServerProven
	  website <http://www.pc.ibm.com/ww/eserver/xseries/serverproven> for
	  information on the specific driver level and support statement
	  for your IBM server.


	  If unsure, say N.

config BATTCHARGE_MONITOR
	tristate "Battery and charger monitoring"
	help
	  Say Y here to enable monitoring of battery and charger using
	  sysfs interface.

config GPIOED
	tristate "GPIOED"
	depends on ARCH_PXA
        default n
        help
	  Gpioed: only for debuging and testing!

config GPIOEDNG
	tristate "GPIOEDNG"
	depends on ARCH_PXA
	default n
	help
	  Gpioed-ng: only for debuging and testing!

config PALMLCD_BORDER
	tristate "Palm LCD Display border switch"
	depends on ARCH_PXA
	help
	    Enable support for turning LCD border on/off

menu "Multimedia Capabilities Port drivers"

config MCP_UCB1x00_AUDIO
	tristate "Support Audio on UCB1x00"
	depends on MCP_UCB1200

config MCP_UCB1x00_SIMPAD_SWITCHES
	tristate "SIMpad Switches Support"
	depends on MCP_UCB1200 && SA1100_SIMPAD

endmenu

source drivers/misc/adc/Kconfig

config SGI_IOC4
	tristate "SGI IOC4 Base IO support"
	depends on PCI
	---help---
	  This option enables basic support for the IOC4 chip on certain
	  SGI IO controller cards (IO9, IO10, and PCI-RT).  This option
	  does not enable any specific functions on such a card, but provides
	  necessary infrastructure for other drivers to utilize.

	  If you have an SGI Altix with an IOC4-based card say Y.
	  Otherwise say N.

config TIFM_CORE
	tristate "TI Flash Media interface support (EXPERIMENTAL)"
	depends on EXPERIMENTAL && PCI
	help
	  If you want support for Texas Instruments(R) Flash Media adapters
	  you should select this option and then also choose an appropriate
	  host adapter, such as 'TI Flash Media PCI74xx/PCI76xx host adapter
	  support', if you have a TI PCI74xx compatible card reader, for
	  example.
	  You will also have to select some flash card format drivers. MMC/SD
	  cards are supported via 'MMC/SD Card support: TI Flash Media MMC/SD
	  Interface support (MMC_TIFM_SD)'.

          To compile this driver as a module, choose M here: the module will
	  be called tifm_core.

config TIFM_7XX1
	tristate "TI Flash Media PCI74xx/PCI76xx host adapter support (EXPERIMENTAL)"
	depends on PCI && TIFM_CORE && EXPERIMENTAL
	default TIFM_CORE
	help
	  This option enables support for Texas Instruments(R) PCI74xx and
	  PCI76xx families of Flash Media adapters, found in many laptops.
	  To make actual use of the device, you will have to select some
	  flash card format drivers, as outlined in the TIFM_CORE Help.

          To compile this driver as a module, choose M here: the module will
	  be called tifm_7xx1.

config ASUS_LAPTOP
        tristate "Asus Laptop Extras (EXPERIMENTAL)"
        depends on X86
        depends on ACPI
	depends on EXPERIMENTAL && !ACPI_ASUS
	depends on LEDS_CLASS
	depends on BACKLIGHT_CLASS_DEVICE
        ---help---
	  This is the new Linux driver for Asus laptops. It may also support some
	  MEDION, JVC or VICTOR laptops. It makes all the extra buttons generate
	  standard ACPI events that go through /proc/acpi/events. It also adds
	  support for video output switching, LCD backlight control, Bluetooth and
	  Wlan control, and most importantly, allows you to blink those fancy LEDs.

	  For more information and a userspace daemon for handling the extra
	  buttons see <http://acpi4asus.sf.net/>.

	  If you have an ACPI-compatible ASUS laptop, say Y or M here.

config MSI_LAPTOP
        tristate "MSI Laptop Extras"
        depends on X86
        depends on ACPI_EC
        depends on BACKLIGHT_CLASS_DEVICE
        ---help---
	  This is a driver for laptops built by MSI (MICRO-STAR
	  INTERNATIONAL):

	  MSI MegaBook S270 (MS-1013)
	  Cytron/TCM/Medion/Tchibo MD96100/SAM2000

	  It adds support for Bluetooth, WLAN and LCD brightness control.

	  More information about this driver is available at
	  <http://0pointer.de/lennart/tchibo.html>.

	  If you have an MSI S270 laptop, say Y or M here.

config SONY_LAPTOP
	tristate "Sony Laptop Extras"
	depends on X86 && ACPI
	select BACKLIGHT_CLASS_DEVICE
	  ---help---
	  This mini-driver drives the SNC device present in the ACPI BIOS of
	  the Sony Vaio laptops.

	  It gives access to some extra laptop functionalities. In its current
	  form, this driver let the user set or query the screen brightness
	  through the backlight subsystem and remove/apply power to some
	  devices.

	  Read <file:Documentation/sony-laptop.txt> for more information.

endmenu

menu "Compaq/iPAQ Drivers"

comment "Compaq/HP iPAQ Drivers"

config IPAQ_SLEEVE
	tristate "Compaq iPAQ Handheld sleeve support"
	help
	  Choose this option to enable support for extension packs (sleeves)
	  for the Compaq iPAQ H3XXX series of handheld computers.  This option
	  is required for the CF, PCMCIA, Bluetooth and GSM/GPRS extension
	  packs.

config SLEEVE_DEBUG
        bool "iPAQ sleeve debugging messages"
        help
          Choose Y if you need to debug sleeve drivers. otherwise say N.

#config IPAQ_ASIC2_OWM
#	tristate "HTC ASIC2 one-wire driver"
#	depends on HTC_ASIC2 && ONEWIRE

#config IPAQ_ASIC2_SLEEVE
#	tristate "HTC ASIC2 sleeve driver"
#	depends on HTC_ASIC2 && IPAQ_SLEEVE

#config IPAQ_SAMCOP_FSI
#	tristate "HP iPAQ SAMCOP FSI driver"
#	depends on SOC_SAMCOP
#	help
#	  Provides access to the samcop portion of the fingerprint scanner
#	  on the h5[5,4]xx. It also provides the /dev/misc/fsi0 device to
#	  userspace users of the scanner.

config IPAQ_SAMCOP_SLEEVE
	tristate "HP iPAQ SAMCOP Sleeve driver"
	depends on SOC_SAMCOP && IPAQ_SLEEVE
	help
	  Choose this option to enable support for extension packs (sleeves)
	  for samcop based iPAQs (h5[5,4]xx) handheld computers. This option
	  is required for CF, PCMCIA and other extension packs.

endmenu
```

## drivers/misc/Kconfig.ipaq
```kconfig
menu "Compaq/iPAQ Drivers"

comment "Compaq/HP iPAQ Drivers"

config IPAQ_SLEEVE
	tristate "Compaq iPAQ Handheld sleeve support"
	help
	  Choose this option to enable support for extension packs (sleeves)
	  for the Compaq iPAQ H3XXX series of handheld computers.  This option
	  is required for the CF, PCMCIA, Bluetooth and GSM/GPRS extension
	  packs.

config IPAQ_ASIC2_OWM
	tristate "HTC ASIC2 one-wire driver"
	depends on HTC_ASIC2 && ONEWIRE

config IPAQ_ASIC2_SLEEVE
	tristate "HTC ASIC2 sleeve driver"
	depends on HTC_ASIC2 && IPAQ_SLEEVE

config IPAQ_SAMCOP_FSI
	tristate "HP iPAQ SAMCOP FSI driver"
	depends on SOC_SAMCOP
	help
	  Provides access to the samcop portion of the fingerprint scanner
	  on the h5[5,4]xx. It also provides the /dev/misc/fsi0 device to
	  userspace users of the scanner.

config IPAQ_SAMCOP_SLEEVE
	tristate "HP iPAQ SAMCOP Sleeve driver"
	depends on SOC_SAMCOP && IPAQ_SLEEVE
	help
	  Choose this option to enable support for extension packs (sleeves)
	  for samcop based iPAQs (h5[5,4]xx) handheld computers. This option
	  is required for CF, PCMCIA and other extension packs.

endmenu
```

## drivers/misc/adc/Kconfig
```kconfig
config ADC
	tristate "ADC class support"
	help
	    This option enables ADC class device drivers.

config ADC_ADS7846_SSP
	tristate "Light-weight ADS7846 driver"
	depends on ADC
	help
	    Light-weight driver for ADS7846 ADC/Touchscreen controller,
	    communication over SSP. Suitable for touchscreen, battery,
	    tempreture, etc. sampling.

config ADC_TSC2200_SSP
	tristate "Light-weight TSC2200 driver"
	depends on ADC
	help
	    Light-weight driver for TSC2200 ADC/Touchscreen controller,
	    communication over SSP. Suitable for touchscreen, battery,
	    temperature, etc. sampling.

config ADC_AD7877
	tristate "Generic ADC API AD7877 driver"
	depends on ADC
	help
	    Generic ADC API driver for AD7877 ADC/Touchscreen controller.
	    Suitable for touchscreen, battery, tempreture, etc. sampling.

config ADC_ASIC2
	tristate "ASIC2 ADC driver"
	depends on HTC_ASIC2
	help
	    Driver for ASIC2 ADC.

config ADC_SAMCOP
	tristate "SAMCOP/HAMCOP ADC driver"
	depends on ADC && (SOC_SAMCOP || SOC_HAMCOP)
	help
	    Driver for SAMCOP/HAMCOP ADC.
```

## drivers/video/imageon/Kconfig
```kconfig
config FB_IMAGEON
	bool "ATI Imageon support"
	depends on FB && ARM
	help
	  Frame buffer device driver for the ATI Imageon hardware
	  found in the Toshiba e7xx and other ARM-based machines.
	  Currently only supports e7xx/w100. If unsure, say N.
```

## fs/aufs/Kconfig
```kconfig
config AUFS
 tristate "Another unionfs"
 help
 Aufs is a stackable unification filesystem such as Unionfs,
 which unifies several directories and provides a merged single
 directory.
 In the early days, aufs was entirely re-designed and
 re-implemented Unionfs Version 1.x series. After many original
 ideas, approaches and improvements, it becomes totally
 different from Unionfs while keeping the basic features.
 See Unionfs for the basic features.
if AUFS
config AUFS_NWKQ_DEF
 int "Number of aufs kernel threads"
 depends on AUFS
 default "4"
 help
  Those  threads  stay  in  the  system  and handle the special  I/O  requests
  from  aufs.   The default value is 4.  If you enable CONFIG_SYSFS, you can
  check  this  value  through <sysfs>/module/aufs/parameters/nwkq.  So   how
  many   threads   is  enough?  You  can  check  it  by <sysfs>/fs/aufs/stat,
  if you enable CONFIG_AUFS_SUSAUFS too.  It shows  the maximum  number of the
  enqueued work at a time per a thread. Usually they are all small numbers or
  0. If  your  work- load is heavy and you feel the response is low, then check
  these values. If there are no zero and any of them is larger than 2 or 3,
  you  should  set  'nwkq'  module  parameter greater then the default value.
  But the reason of the bad response  is  in your branch  filesystem,  to
  increase the number of aufs thread will not help you.  The last number in
  <sysfs>/fs/aufs/stat after comma is the maxi- mum  number of  the  'no-wait'
  enqueued  work  at a time. Aufs enqueues  such  work  to the  system  global
  workqueue  called 'events', but doesn't wait for its completion. Usually they
  does no harm the time-performance of aufs.
config AUFS_FAKE_DM
 bool "Use simplified (fake) nameidata"
 depends on AUFS
 default y
 help
 Faking nameidata (VFS internal data), you can get better performance
 in some cases.
choice
 prompt "Maximum number of branches"
 depends on AUFS
 default AUFS_BRANCH_MAX_127
 help
 Specifies the maximum number of branches (or member directories) in a single aufs. The larger value consumes more system resources and has an impact to performance.
config AUFS_BRANCH_MAX_127
 bool "127"
 help
 Specifies the maximum number of branches (or member directories) in a single aufs. The larger value consumes more system resources and has an impact to performance.
config AUFS_BRANCH_MAX_511
 bool "511"
 help
 Specifies the maximum number of branches (or member directories) in a single aufs. The larger value consumes more system resources and has an impact to performance.
config AUFS_BRANCH_MAX_1023
 bool "1023"
 help
 Specifies the maximum number of branches (or member directories) in a single aufs. The larger value consumes more system resources and has an impact to performance.
config AUFS_BRANCH_MAX_32767
 bool "32767"
 help
 Specifies the maximum number of branches (or member directories) in a single aufs. The larger value consumes more system resources and has an impact to performance.
endchoice
config AUFS_SYSAUFS
 bool "Use <sysfs>/fs/aufs"
 depends on AUFS
 depends on SYSFS
 default y
 help
 Aufs creates some files under sysfs for various purposes.
 If the number of your branches is large or their path is long
 and you meet the limitation of mount(8), /etc/mtab or
 /proc/mount, you need to enable this option and set aufs
 module parameter brs=1.
 See detail in aufs.5.
comment "SYSAUFS and AUFS_SYSAUFS are disabled"
 depends on SYSFS = n
config AUFS_HINOTIFY
 bool "Use inotify to detect actions on a branch"
 depends on AUFS
 depends on INOTIFY
 default n
 help
 If you want to modify files on branches directly, eg. bypassing aufs,
 and want aufs to detect the changes of them fully, then enable this
 option and use 'udba=inotify' mount option.
 It will damage the performance.
 See detail in aufs.5.
comment "INOTIFY and AUFS_HINOTIFY are disabled"
 depends on INOTIFY = n
config AUFS_EXPORT
 bool "NFS-exportable aufs"
 depends on AUFS
 depends on (AUFS = y && EXPORTFS = y) || (AUFS = m && EXPORTFS)
 default n
 help
 If you want to export your mounted aufs, then enable this
 option. There are several requirements to export aufs.
 See detail in aufs.5.
comment "EXPORTFS and AUFS_EXPORT are disabled"
 depends on AUFS
 depends on EXPORTFS = n
comment "AUFS_EXPORT is disabled since EXPORTFS is a module but AUFS"
 depends on AUFS
 depends on EXPORTFS = m && AUFS = y
config AUFS_KSIZE_PATCH
 bool "ksize.patch was applied or not"
 depends on AUFS
 depends on AUFS = m
 default n
 help
 Aufs sometimes needs to re-allocate memory. If 'ksize' kernel internal
 function is exported to modules, aufs runs efficiently in some cases.
 If you applied 'CVS_TREE/aufs/ksize.patch' to your kernel and you are
 compiling aufs as a module, then enable this option.
 The ksize.patch does nothing but export the function.
config AUFS_LHASH_PATCH
 bool "lhash.patch for NFS branch was applied or not"
 depends on AUFS
 depends on NFS_FS
 default n
 help
 If you use mounted NFS as an aufs branch filesystem, then you need to
 apply the patch 'CVS_TREE/aufs/lhash.patch' to your kernel source, and
 enable this configuration.
 The lhash.patch makes the kernel function __lookup_hash() global and
 exports it to modules.
comment "NFS_FS and AUFS_LHASH_PATCH are disabled"
 depends on AUFS
 depends on NFS_FS = n
config AUFS_DEBUG
 bool "Debug aufs"
 depends on AUFS
 default y
 help
 Enable this to compile aufs internal debug code.
 The performance will be damaged.
config AUFS_COMPAT
 bool "Compatibility with Unionfs (obsolete)"
 depends on AUFS
 default n
 help
 This makes aufs compatible with unionfs-style mount options and some
 behaviours.
 The dirs= mount option and =nfsro branch permission flag are always
 interpreted as br: mount option and =ro flag respectively. The
 'debug', 'delete' and 'imap' mount options are ignored.
 If you disable this option, you will get,
 - aufs issues a warning about the ignored mount options
 - the default branch permission flag is set. RW for the first branch,
   and RO for the rests.
 - the name of a internal file which represents the directory is
   'opaque', becomes '.wh..wh..opq'
 - the 'diropq=w' mount option is set by default
endif
```
