## fs/squashfs_lzma/Kconfig
```kconfig
#
# SquashFS-LZMA configuration
#

config SQUASHFS_LZMA
	tristate "SquashFS-LZMA - Squashed file system with LZMA support"
	select ZLIB_INFLATE
	help
	  Saying Y here includes support for SquashFS 3.2 (a Compressed Read-Only File
	  System).  Squashfs is a highly compressed read-only filesystem for Linux.
	  It uses zlib compression to compress both files, inodes and directories.
	  Inodes in the system are very small and all blocks are packed to minimise
	  data overhead. Block sizes greater than 4K are supported up to a maximum of 64K.
	  SquashFS 3.1 supports 64 bit filesystems and files (larger than 4GB), full
	  uid/gid information, hard links and timestamps.

	  Squashfs is intended for general read-only filesystem use, for archival
	  use (i.e. in cases where a .tar.gz file may be used), and in embedded
	  systems where low overhead is needed.  Further information and filesystem tools
	  are available from http://squashfs.sourceforge.net.

	  If you want to compile this as a module ( = code which can be
	  inserted in and removed from the running kernel whenever you want),
	  say M here and read <file:Documentation/modules.txt>.  The module
	  will be called squashfs.  Note that the root file system (the one
	  containing the directory /) cannot be compiled as a module.

	  If unsure, say N.


config SQUASHFS_LZMA_EMBEDDED
	bool "Additional options for memory-constrained systems" 
	depends on SQUASHFS_LZMA
	default n
	help
	  Saying Y here allows you to specify cache sizes and how Squashfs
	  allocates memory.  This is only intended for memory constrained
	  systems.

	  If unsure, say N.

config SQUASHFS_LZMA_FRAGMENT_CACHE_SIZE
	int "Number of fragments cached" if SQUASHFS_LZMA_EMBEDDED
	depends on SQUASHFS_LZMA
	default "3"
	help
	  By default SquashFS caches the last 3 fragments read from
	  the filesystem.  Increasing this amount may mean SquashFS
	  has to re-read fragments less often from disk, at the expense
	  of extra system memory.  Decreasing this amount will mean
	  SquashFS uses less memory at the expense of extra reads from disk.

	  Note there must be at least one cached fragment.  Anything
	  much more than three will probably not make much difference.

config SQUASHFS_LZMA_VMALLOC
	bool "Use Vmalloc rather than Kmalloc" if SQUASHFS_LZMA_EMBEDDED
	depends on SQUASHFS_LZMA
	default n
	help
	  By default SquashFS uses kmalloc to obtain fragment cache memory.
	  Kmalloc memory is the standard kernel allocator, but it can fail
	  on memory constrained systems.  Because of the way Vmalloc works,
	  Vmalloc can succeed when kmalloc fails.  Specifying this option
	  will make SquashFS always use Vmalloc to allocate the
	  fragment cache memory.

	  If unsure, say N.
```

## lab/Kconfig
```kconfig
#
# Linux As Bootloader menu
#

menu "Linux As Bootloader"

config LAB
	bool "Linux As Bootloader (READ HELP!)"
	default n
	select LAB_ARMBOOT
	select ARMBOOT
	select LAB_COPY
	select LAB_RUN
	help
	  Linux As Bootloader is a project to allow bootstrapping of embedded
	  systems such as the HP/Compaq iPAQ using the Linux kernel.

	  If you enable the LAB option, the resulting kernel will not be
	  suitable as a general-purpose kernel; many unused things will be
	  ommited from kernel in order to make it as small as possible.

	  Presently, LAB is experimental.

config LAB_BOOTSTRAP
	bool "Enable bootstrap code for LAB"
	depends on LAB
	default y
	help
	  Unless you know what you're doing, say y.

config LAB_DEBUG
	bool "LAB debugging support"
	depends on LAB_BOOTSTRAP
	default n
	help
	  Enable this to add optional code to LAB startup that helps
	  identifying and debugging problems on boot, suspend/resume
	  and so on.

choice
	prompt "LAB debug messages device"
	depends on LAB_DEBUG

config LAB_DEBUG_JTAG
	bool "JTAG"
	help
	  Output debug messages through the JTAG interface. You will need
	  a JTAG cable and special software on the PC for this to work.

config LAB_DEBUG_FFUART
	bool "FFUART"
	help
	  Output debug messages through the FFUART (Fully-Featured) serial
	  controller. Some PDA use this port for communication with PC.
	  Under Linux this port is normally seen as /dev/ttyS0.

config LAB_DEBUG_BTUART
	bool "BTUART"
	help
	  Output debug messages through the BTUART (BlueTooth) serial
	  controller. Some PDA use this port for communication with PC.
	  Under Linux this port is normally seen as /dev/ttyS1.

config LAB_DEBUG_STUART
	bool "STUART"
	help
	  Output debug messages through the STUART (STandard) serial
	  controller. Most PDA use this port for infra-red communications.
	  This is useful if you have a infrared adapter on your PC that
	  can work as a regular serial port. Under Linux this port is
	  normally seen as /dev/ttyS2.

config LAB_DEBUG_DISPLAY
	bool "Display"
	help
	  This option has a limited use because the LCD controller needs
	  to be initialized prior to running LAB. It is mostly useful for
	  debugging LAB by running it from WinCE via some tool like
	  linexec or HaRET. Also you will have to define the screen size
	  and also the starting physical address of video memory.

endchoice

config LAB_DISPLAY_ADDR
	hex "Physical video memory address"
	depends on LAB && LAB_DEBUG_DISPLAY
	default "0x14002000"

config LAB_DISPLAY_W
	int "Horizontal screen resolution"
	depends on LAB && LAB_DEBUG_DISPLAY
	default "240"

config LAB_DISPLAY_H
	int "Vertical screen resolution"
	depends on LAB && LAB_DEBUG_DISPLAY
	default "320"

config LAB_DISPLAY_BPP
	int "Display bytes per pixel (1, 2, 4)"
	depends on LAB && LAB_DEBUG_DISPLAY
	default "2"
	range 1 4


source "lab/modules/Kconfig"

endmenu
```

## lab/modules/Kconfig
```kconfig
comment "LAB modules"
	depends on LAB

config LAB_BOOTLOGO
	bool "Logo shown on boot without fbcon"
	depends on LAB
	default y
	help
	  Adds an initial image to be displayed while the device boots.
	  
	  Unless you have a ROM space crisis, say y.

config LAB_DUMMY
	depends on LAB
	tristate "LAB Dummy module"

config LAB_PM
	depends on LAB && PM
	tristate "LAB power management module"

config LAB_DMESG
	depends on LAB
	tristate "LAB dmesg module"

config LAB_DEBUGLOG
	depends on LAB
	tristate "LAB debug log module"

config LAB_DEVMEM
	depends on LAB
	tristate "LAB devmem module"

config LAB_CRC
	depends on LAB
	tristate "LAB CRC module"

config LAB_XMODEM
	depends on LAB && LAB_CRC
	tristate "LAB XMODEM send module"

config LAB_YMODEM
	depends on LAB && LAB_CRC
	tristate "LAB YMODEM receive module"

config LAB_MTD
	depends on LAB && MTD_PARTITIONS
	tristate "LAB MTD partitioning module"

config LAB_ERASEMTD
	depends on LAB && MTD
	tristate "LAB MTD erase module"

config LAB_COPY
	depends on LAB
	tristate "LAB copy module"

config LAB_COPY_YMODEM
	depends on LAB_COPY && LAB_YMODEM
	tristate "YMODEM copy source"

config LAB_COPY_XMODEM
	depends on LAB_COPY && LAB_XMODEM
	tristate "XMODEM copy target"

config LAB_COPY_FLASH
	depends on LAB_COPY && MTD
	tristate "Flash copy source/target"

config LAB_COPY_NAND
	depends on LAB_COPY && MTD_NAND
	tristate "NAND flash copy source/target"

config LAB_COPY_FS
	depends on LAB_COPY
	tristate "Filesystem copy source/target"

config LAB_COPY_BUF
	depends on LAB_COPY
	tristate "Vmalloc buffer copy source/target"

config LAB_COPY_DUMMY
	depends on LAB_COPY
	tristate "Dummy copy source/target"

config LAB_COPY_WRAPPER
	depends on LAB_COPY
	tristate "Compatibility wrappers (e.g. load root)"

config LAB_INSMOD
	depends on LAB_COPY=y && MODULES
	bool "LAB insmod module"

config LAB_RMMOD
	depends on LAB_INSMOD && MODULE_UNLOAD
	bool "LAB rmmod module"

config LAB_MOUNT
	depends on LAB
	bool "LAB mount module"

config LAB_MKNOD
	depends on LAB
	bool "LAB mknod module"

config LAB_MKDIR
	depends on LAB
	bool "LAB mkdir module"

config ARMBOOT
	depends on LAB && ARM
	bool "ARMBoot kernel loader"

config ARMBOOT_LBL_SYSCALL
	depends on ARMBOOT
	bool "ARMBoot LBL syscall support"

config LAB_ARMBOOT
	depends on LAB_COPY && ARMBOOT
	tristate "LAB ARMBoot module"

config LAB_NANDDUMP
	depends on LAB && MTD_NAND
	tristate "NAND dumper module"

config LAB_NANDCHECK
	depends on LAB && MTD_NAND
	tristate "NAND checker module"

config LAB_RUN
	depends on LAB
	tristate "LAB script module"

config LAB_CAT
	depends on LAB
	tristate "LAB cat module"

config LAB_HEXDUMP
	depends on LAB
	tristate "LAB hexdump module"

config LAB_LS
	depends on LAB
	tristate "LAB ls module"

config LAB_LSBLK
	depends on LAB
	tristate "LAB ls block devices module"
```

## sound/arm/Kconfig
```kconfig
# ALSA ARM drivers

menu "ALSA ARM devices"
	depends on SND!=n && ARM

config SND_A620
	tristate "Asus MyPal 620 driver"
	depends on MACH_A620 && SND && I2C
	select SND_PXA2xx_I2SOUND
	select SND_UDA1380
	help
	  Say Y or M if you have a Asus MyPal 620 and want audio support

config SND_A716
	tristate "Asus MyPal 716 driver"
	depends on MACH_A716 && SND && I2C
	select SND_PXA2xx_I2SOUND
	select SND_UDA1380
	help
	  Say Y or M if you have a Asus MyPal 716 and want audio support

config SND_H1910
	tristate "iPAQ h1910 driver"
	depends on ARCH_H1900 && SND && I2C
	select SND_PXA2xx_I2SOUND
	select SND_UDA1380
	help
	  Say Y or M if you have a HP iPAQ h1910 and want audio support

config SND_H2200
	tristate "iPAQ h2200 driver"
	depends on ARCH_H2200 && SND && I2C
	select SND_PXA2xx_I2SOUND
	select SND_UDA1380
	help
	  Say Y or M if you have an HP iPAQ H22xx and want audio support

config SND_H4000
	tristate "iPAQ h4000 driver"
	depends on MACH_H4000 && SND && I2C
	select SND_PXA2xx_I2SOUND
	select SND_UDA1380
	help
	  Say Y or M if you have an HP iPAQ H4xxx and want audio support

config SND_HX4700
	tristate "iPAQ hx4700 driver"
	depends on MACH_H4700 && SND && I2C
	select SND_PXA2xx_I2SOUND
	select SND_AK4641
	help
	  Say Y or M if you have a HP iPAQ hx470x and want audio support

config SND_HTCAPACHE
	tristate "HTC Apache driver"
	depends on MACH_HTCAPACHE && SND && I2C
	select SND_PXA2xx_I2SOUND
	select SND_AK4641
	help
	  Say Y or M if you have a HTC Apache and want audio support

config SND_HTCUNIVERSAL
	tristate "HTC Universal driver"
	depends on MACH_HTCUNIVERSAL && SND && I2C
	select SND_PXA2xx_I2SOUND
#	select SND_AK4641
	select HTCUNIVERSAL_AK4641
	help
	  Say Y or M if you have a HTC Universal and want audio support
	
config SND_HTCSABLE
	tristate "HTC Sable driver"
	depends on MACH_HW6900 && SND && I2C
	select SND_PXA2xx_I2SOUND
	select SND_AK4641
	help
	  Say Y or M if you have a HTC Sable and want audio support
	
config SND_SA11XX_UDA1341
	tristate "SA11xx UDA1341TS driver (H31xx/H36xx/H37xx/H38xx)"
	depends on ARCH_SA1100 && SND && L3
	select SND_PCM
	help
	  Say Y here if you have a Compaq iPaq H3x00 handheld computer
	  and want to use its Philips UDA 1341 audio chip.

	  To compile this driver as a module, choose M here: the module
	  will be called snd-sa11xx-uda1341.

config SND_H5XXX_AK4535
	tristate "PXA2xx AK4535 driver (H5xxx)"
	depends on ARCH_H5400 && SND && I2C
	help
	  Say Y or M if you have a Compaq iPaq H5xxx handheld computer and want
	  to use its AKM AK4535 audio chip.

config SND_SA11X0_SSP
	tristate

config SND_UDA1341
	tristate

config SND_ARMAACI
	tristate "ARM PrimeCell PL041 AC Link support"
	depends on SND && ARM_AMBA
	select SND_PCM
	select SND_AC97_CODEC

config SND_PXA2xx_I2SOUND
	tristate "PXA2 I2Sound support"
	depends on SND
	select SND_PCM

config SND_PXA2XX_PCM
	tristate
	select SND_PCM

config SND_PXA2XX_AC97
	tristate "AC97 driver for the Intel PXA2xx chip"
	depends on ARCH_PXA && SND
	select SND_PXA2XX_PCM
	select SND_AC97_CODEC
	help
	  Say Y or M if you want to support any AC97 codec attached to
	  the PXA2xx AC97 interface.

config SND_S3C2410
       tristate "S3C24XX Sound core"
       depends on ARCH_S3C2410 && SND
       select SND_PCM
       help
         Say Y here if you want to use the inbuilt audio controller
         on the S3C2410 or S3C2440

config SND_S3C2410_DBG
       bool "S3C24XX sound core debug"
       depends on SND_S3C2410
       help
         Say Y here to enable the debugging in the s3c24xx-iis core
         driver.

config SND_S3C2410_DBG_DMA
       bool "S3C24XX sound core DMA debug"
       depends on SND_S3C2410
       help
         Say Y here to enable the dma debugging in the s3c24xx-iis
         driver. 

config SND_RECON
        tristate "Recon sound driver"
	depends on ARCH_PXA && SND && I2C
	select SND_PXA2xx_I2SOUND
	select SND_PCM
	select SND_HWDEP
		help
		Say M if you have a TDS Recon and want audio support

endmenu
```

## sound/i2c/Kconfig
```kconfig
config SND_UDA1380
	depends on SND && I2C
	tristate

config SND_AK4641
	depends on SND && I2C
	tristate
```

## sound/soc/codecs/Kconfig
```kconfig
config SND_SOC_AC97_CODEC
	tristate "SoC generic AC97 support"
	depends SND_SOC
	help
	  Say Y or M if you want generic AC97 support. This is not required
	  for the AC97 codecs listed below.

config SND_SOC_WM8711
	tristate "SoC driver for the WM8711 codec"
	depends SND_SOC
	help
	  Say Y or M if you want to support the WM8711 codec.

config SND_SOC_WM8510
	tristate "SoC driver for the WM8510 codec"
	depends SND_SOC
	help
	  Say Y or M if you want to support the WM8711 codec.

config SND_SOC_WM8731
	tristate "SoC driver for the WM8731 codec"
	depends SND_SOC
	help
	  Say Y or M if you want to support the WM8731 codec.

config SND_SOC_WM8750
	tristate "SoC driver for the WM8750 codec"
	depends SND_SOC
	help
	  Say Y or M if you want to support the WM8750 codec.

config SND_SOC_WM8753
	tristate "SoC driver for the WM8753 codec"
	depends SND_SOC
	help
	  Say Y or M if you want to support the WM8753 codec.

config SND_SOC_WM8772
	tristate "SoC driver for the WM8772 codec"
	depends SND_SOC
	help
	  Say Y or M if you want to support the WM8772 codec.

config SND_SOC_WM8971
	tristate "SoC driver for the WM8971 codec"
	depends SND_SOC
	help
	  Say Y or M if you want to support the WM8971 codec.

config SND_SOC_WM8956
	tristate "SoC driver for the WM8956 codec"
	depends SND_SOC
	help
	  Say Y or M if you want to support the WM8956 codec.

config SND_SOC_WM8960
	tristate "SoC driver for the WM8960 codec"
	depends SND_SOC
	help
	  Say Y or M if you want to support the WM8960 codec.

config SND_SOC_WM8976
	tristate "SoC driver for the WM8976 codec"
	depends SND_SOC
	help
	  Say Y or M if you want to support the WM8976 codec.

config SND_SOC_WM8974
	tristate "SoC driver for the WM8974 codec"
	depends SND_SOC
	help
	  Say Y or M if you want to support the WM8974 codec.

config SND_SOC_WM8980
	tristate "SoC driver for the WM8980 codec"
	depends SND_SOC
	help
	  Say Y or M if you want to support the WM8980 codec.

config SND_SOC_WM9713
	tristate "SoC driver for the WM9713 codec"
	depends SND_SOC
	help
	  Say Y or M if you want to support the WM9713 codec.

config SND_SOC_WM9712
	tristate "SoC driver for the WM9712 codec"
	depends SND_SOC
	help
	  Say Y or M if you want to support the WM9712 codec.

config SND_SOC_UDA1380
	tristate "SoC driver for the UDA1380 codec"
	depends SND_SOC
	help
	  Say Y or M if you want to support the UDA1380 codec.

config SND_SOC_AK4535
	tristate "SoC driver for the AK4535 codec"
	depends SND_SOC
	help
	  Say Y or M if you want to support the AK4535 codec.
```
