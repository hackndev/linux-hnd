## arch/arm/mach-pxa/h4000/Kconfig
```kconfig
menuconfig MACH_H4000
        bool "HP iPAQ h4000"
        depends on ARCH_PXA
        select PXA25x
	select BOARD_IRQ_MAP_BIG
	select PXA_SSP

config MACH_H4300
        bool "Support for HP iPAQ h4300 model"
        depends on MACH_H4000

config IPAQ_H4000_IRDA
        tristate "IrDA port support"
        depends on MACH_H4000 && HTC_ASIC3

config IPAQ_H4000_LCD
        tristate "LCD support"
        depends on MACH_H4000 && HTC_ASIC3 && LCD_CLASS_DEVICE && FB_PXA

config IPAQ_H4000_BACKLIGHT
        bool "LCD Backlight support"
        depends on MACH_H4000 && HTC_ASIC3 && BACKLIGHT_CLASS_DEVICE

config IPAQ_H4000_PCMCIA
        tristate "PCMCIA support"
	default n
        depends on MACH_H4000 && HTC_ASIC3 && PCMCIA_PXA2XX
        help
          Enables h4000 specific functions for the PXA2xx PCMCIA driver.
	  This driver is required to get builtin WiFi working.

config IPAQ_H4000_BUTTONS
        tristate "Buttons support"
        depends on MACH_H4000 && HTC_ASIC3

config IPAQ_H4000_LEDS
	tristate "HP iPAQ h4000 LEDs"
	depends on MACH_H4000
	select NEW_LEDS
	select LEDS_ASIC3
	help
	  This enables support for HP iPAQ h4000 color LED control
          (via the ASIC3 chip).

config IPAQ_H4000_BT
        tristate "Bluetooth support"
        depends on MACH_H4000 && HTC_ASIC3

config IPAQ_H4300_KBD
        tristate "Keyboard support for h4300 model"
        depends on MACH_H4300 && HTC_ASIC3
```

## arch/arm/mach-pxa/h5400/Kconfig
```kconfig
menuconfig ARCH_H5400
        bool "HP iPAQ h5400"
        depends on ARCH_PXA
        select PXA25x
	select BOARD_IRQ_MAP_BIG
	select DMABOUNCE

config IPAQ_H5400_BT
	tristate "HP iPAQ h5400 Bluetooth"
	depends on ARCH_H5400 && SOC_SAMCOP

config IPAQ_H5400_LCD
	tristate "HP iPAQ h5400 LCD"
	depends on ARCH_H5400 && LCD_CLASS_DEVICE && FB_MQ1100

config IPAQ_H5400_BL
	tristate "HP iPAQ h5400 Backlight"
	depends on ARCH_H5400 && IPAQ_H5400_LCD && BACKLIGHT_CORGI

config IPAQ_H5400_WIFI
	tristate "HP iPAQ h5400 wifi"
	depends on ARCH_H5400 && USB && USB_OHCI_HCD

config IPAQ_H5400_AUDIO
	tristate "HP iPAQ h5400 audio"
	depends on ARCH_H5400 && SND_H5XXX_AK4535
```

## arch/arm/mach-pxa/htcalpine/Kconfig
```kconfig
menuconfig MACH_HTCALPINE
	bool "HTC Alpine"
	select PXA27x
	help
		Say Y here if you intend to run this kernel on a
		HTC Alpine. Currently there is only basic support
		for this PDA.

config HTCALPINE_CPLD
	tristate "HTC Alpine CPLD driver"
	depends on MACH_HTCALPINE
	help
	  This driver is supposed to test the Alpine's CPLD.

config HTCALPINE_PHONE
	tristate "HTC Alpine Phone driver"
	depends on MACH_HTCALPINE
	help
	  Experimental driver for the Alpine's GSM chipset connected
	  to BTUART(cmd) and ASIC5 uart(data).
```
