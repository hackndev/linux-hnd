## arch/arm/armboot/Kconfig
```kconfig
config ARMBOOT_PROC
	bool "ARMBoot Linux booting Linux"
	depends on ARM
	help
	  ARMBoot allows you to boot another kernel using
	  interface in /proc/armboot.
	  
	  Usage: echo -ne '/zImage\0' > /proc/armboot
```

## arch/arm/mach-pxa/Kconfig
```kconfig
if ARCH_PXA

menu "Intel PXA2xx Implementations"

config ARCH_LUBBOCK
	bool "Intel DBPXA250 Development Platform"
	select PXA25x
	select SA1111

config MACH_LOGICPD_PXA270
	bool "LogicPD PXA270 Card Engine Development Platform"
	select PXA27x

config MACH_MAINSTONE
	bool "Intel HCDDBBVA0 Development Platform"
	select PXA27x

config ARCH_PXA_IDP
	bool "Accelent Xscale IDP"
	select PXA25x

source "arch/arm/mach-pxa/eseries/Kconfig"
source "arch/arm/mach-pxa/asus620/Kconfig"
source "arch/arm/mach-pxa/asus716/Kconfig"
source "arch/arm/mach-pxa/asus730/Kconfig"
source "arch/arm/mach-pxa/h1900/Kconfig"
source "arch/arm/mach-pxa/h2200/Kconfig"
source "arch/arm/mach-pxa/h3900/Kconfig"
source "arch/arm/mach-pxa/h4000/Kconfig"
source "arch/arm/mach-pxa/hx4700/Kconfig"
source "arch/arm/mach-pxa/hx2750/Kconfig"
source "arch/arm/mach-pxa/h5400/Kconfig"
source "arch/arm/mach-pxa/htchimalaya/Kconfig"
source "arch/arm/mach-pxa/htcuniversal/Kconfig"
source "arch/arm/mach-pxa/htcalpine/Kconfig"
source "arch/arm/mach-pxa/magician/Kconfig"
source "arch/arm/mach-pxa/htcapache/Kconfig"
source "arch/arm/mach-pxa/htcblueangel/Kconfig"
source "arch/arm/mach-pxa/htcsable/Kconfig"
source "arch/arm/mach-pxa/htcathena/Kconfig"
source "arch/arm/mach-pxa/aximx3/Kconfig"
source "arch/arm/mach-pxa/aximx5/Kconfig"
source "arch/arm/mach-pxa/aximx30/Kconfig"
source "arch/arm/mach-pxa/aximx50/Kconfig"
source "arch/arm/mach-pxa/rover/Kconfig"
source "arch/arm/mach-pxa/palmld/Kconfig"
source "arch/arm/mach-pxa/palmt650/Kconfig"
source "arch/arm/mach-pxa/palmt680/Kconfig"
source "arch/arm/mach-pxa/palmt700wx/Kconfig"
source "arch/arm/mach-pxa/palmte2/Kconfig"
source "arch/arm/mach-pxa/palmtt3/Kconfig"
source "arch/arm/mach-pxa/palmtt5/Kconfig"
source "arch/arm/mach-pxa/palmtx/Kconfig"
source "arch/arm/mach-pxa/palmz72/Kconfig"
source "arch/arm/mach-pxa/palmtc/Kconfig"
source "arch/arm/mach-pxa/palmz31/Kconfig"

config MACH_GHI270HG
	bool "Grayhill Duramax HG"

config MACH_GHI270
	bool "Grayhill Duramax H"
	select PXA27x
	select MACH_GHI270HG

config MACH_LOOXC550
	bool "FSC LOOX C550"
	select PXA27x

config PXA_SHARPSL
	bool "SHARP Zaurus SL-5600, SL-C7xx and SL-Cxx00 Models"
	select SHARP_SCOOP
	select SHARP_PARAM
	help
	  Say Y here if you intend to run this kernel on a
	  Sharp Zaurus SL-5600 (Poodle), SL-C700 (Corgi),
	  SL-C750 (Shepherd), SL-C760 (Husky), SL-C1000 (Akita),
	  SL-C3000 (Spitz), SL-C3100 (Borzoi) or SL-C6000x (Tosa)
	  handheld computer.

config MACH_TRIZEPS4
	bool "Keith und Koep Trizeps4 DIMM-Module"
	select PXA27x

if PXA_SHARPSL

choice
	prompt "Select target Sharp Zaurus device range"

config PXA_SHARPSL_25x
	bool "Sharp PXA25x models (SL-5600, SL-C7xx and SL-C6000x)"
	select PXA25x

config PXA_SHARPSL_27x
	bool "Sharp PXA270 models (SL-Cxx00)"
	select PXA27x

endchoice

endif

if MACH_TRIZEPS4

choice
	prompt "Select base board for Trizeps 4 module"

config MACH_TRIZEPS4_CONXS
	bool "ConXS Eval Board"

config MACH_TRIZEPS4_ANY
	bool "another Board"

endchoice

endif

endmenu

config MACH_POODLE
	bool "Enable Sharp SL-5600 (Poodle) Support"
	depends on PXA_SHARPSL_25x
	select SHARP_LOCOMO
	select PXA_SSP

config MACH_CORGI
	bool "Enable Sharp SL-C700 (Corgi) Support"
	depends on PXA_SHARPSL_25x
	select PXA_SHARP_C7xx

config MACH_SHEPHERD
	bool "Enable Sharp SL-C750 (Shepherd) Support"
	depends on PXA_SHARPSL_25x
	select PXA_SHARP_C7xx

config MACH_HUSKY
	bool "Enable Sharp SL-C760 (Husky) Support"
	depends on PXA_SHARPSL_25x
	select PXA_SHARP_C7xx

config MACH_AKITA
	bool "Enable Sharp SL-1000 (Akita) Support"
	depends on PXA_SHARPSL_27x
	select PXA_SHARP_Cxx00
	select MACH_SPITZ
	select I2C
	select I2C_PXA

config MACH_SPITZ
	bool "Enable Sharp Zaurus SL-3000 (Spitz) Support"
	depends on PXA_SHARPSL_27x
	select PXA_SHARP_Cxx00

config MACH_BORZOI
	bool "Enable Sharp Zaurus SL-3100 (Borzoi) Support"
	depends on PXA_SHARPSL_27x
	select PXA_SHARP_Cxx00

config MACH_TOSA
	bool "Enable Sharp SL-6000x (Tosa) Support"
	depends on PXA_SHARPSL_25x

config PXA25x
	bool
	help
	  Select code specific to PXA21x/25x/26x variants

config PXA26x
	bool
	help
	  Select code specific to PXA26x variants

config PXA27x
	bool
	help
	  Select code specific to PXA27x variants

config PXA_SHARP_C7xx
	bool
	select PXA_SSP
	select SHARPSL_PM
	help
	  Enable support for all Sharp C7xx models

config PXA_SHARP_Cxx00
	bool
	select PXA_SSP
	select SHARPSL_PM
	help
	  Enable common support for Sharp Cxx00 models

config PXA_SSP
	tristate
	help
	  Enable support for PXA2xx SSP ports

config PXA_SUSPEND_SAVE_EXTRA_REGS
	bool
	help
	  Save additional registers on the stack during suspend
	  to work around certain bootloaders overwriting them
	  during resume.

config PXA_SUSPEND_SAVE_EXTRA_REGS
	bool
	help
	  Save additional registers on the stack during suspend
	  to work around certain bootloaders overwriting them
	  during resume.

config PXA27x_VOLTAGE
	tristate "Support PXA27x CPU Core Voltage Change Sequencer"
	depends PXA27x && CPU_FREQ_PXA

config PXA27x_VOLTAGE_MAX158xx
	tristate "MAX158xx PMIC"
	depends on PXA27x_VOLTAGE

endif
```

## arch/arm/mach-pxa/asus620/Kconfig
```kconfig
menuconfig MACH_A620
        bool "Asus 620/620BT"
        select PXA25x
        help
            Asus 620/620BT kernel support

config A620_LCD
        bool "A620 frame buffer LCD"
        depends on MACH_A620 && LCD_CLASS_DEVICE
        help
            LCD support for Asus A620, possibly for other Asus devices

config A620_BUTTONS
        tristate "A620 buttons driver"
        depends on MACH_A620 && INPUT
        help
          This driver translates MyPal A620 button presses to Linux input
          subsystem events.

config A620_PCMCIA
        bool "A620 PCMCIA"
        depends on MACH_A620
        help
          This enables support for using PCMCIA (CompactFlash) cards
          on MyPal. You will also need to enable PXA2xx PCMCIA
          support in the PCMCIA/Cardbus support menu.

config A620_TS
        tristate "A620 Touchscreen"
        depends on MACH_A620
        help
          This enables support for using the touchscreen
          on MyPal.

config A620_FLASHFAKE
        tristate "A620 Disk On Chip driver (DEPRECATED)"
        depends on MACH_A620
        help
          This driver simulate write command on the Disk On Chip of A620
```

## arch/arm/mach-pxa/asus716/Kconfig
```kconfig
menuconfig MACH_A716
        bool "Asus MyPal 716"
	depends on ARCH_PXA
        select PXA25x
	select BOARD_IRQ_MAP_BIG
        help
            Asus MyPal 716 kernel support

config A716_LCD
        tristate "716 frame buffer LCD"
        depends on MACH_A716 && LCD_CLASS_DEVICE
        help
            LCD support for Asus MyPal 716

config A716_PCMCIA
        tristate "716 PCMCIA"
        depends on MACH_A716
        help
          This enables support for using PCMCIA (CompactFlash) cards
          on MyPal. You will also need to enable PXA2xx PCMCIA
          support in the PCMCIA/Cardbus support menu
```

## arch/arm/mach-pxa/asus730/Kconfig
```kconfig
menuconfig MACH_A730
        bool "Asus MyPal A730(W)"
        depends on ARCH_PXA
        select PXA27x
        select IWMMXT
	select I2C
	select SENSORS_PCA9535
	help
           Asus MyPal A730(W) kernel support

config ASUS730_WM9712
        tristate "Asus730 WM9712 driver"
        depends on MACH_A730
```

## arch/arm/mach-pxa/aximx3/Kconfig
```kconfig
menuconfig ARCH_AXIMX3
	bool "Dell Axim X3 (non-functional)"
	select PXA25x
	help
	  Enable this if you plan to boot the kernel on the Dell Axim X3
	  series of PDAs. Currently there is only basic support for this
	  type of PDAs.

config AXIMX3_LCD
	tristate "Dell Axim X3 LCD"
	depends on ARCH_AXIMX3 && LCD_CLASS_DEVICE
	help
	  This driver provides support for changing power, brightness
	  and contrast on Dell Axim X3 LCD display.
```

## arch/arm/mach-pxa/aximx30/Kconfig
```kconfig
menuconfig MACH_X30
	bool "Dell Axim X30 (non-functional)"
	select PXA27x
	select KEYBOARD_GPIO
	depends HTC_ASIC3
	help
	  Enable this if you plan to boot the kernel on the Dell Axim X30
	  series of PDAs. Currently there is only basic support for this
	  type of PDAs.

config X30_CORE
        tristate "Dell Axim X30 Core"
        depends on MACH_X30 && HTC_ASIC3
        help
          This selection enables support for Dell Axim X30 Core
	            Hardware support (ASIC3 and EGPIOs).

config AXIMX30_LCD
	tristate "Dell Axim X30 LCD"
	depends on MACH_X30 && LCD_CLASS_DEVICE
	help
	  This driver provides support for changing power and brightness
	  on Dell Axim X30 LCD display.
```

## arch/arm/mach-pxa/aximx5/Kconfig
```kconfig
menuconfig ARCH_AXIMX5
	bool "Dell Axim X5"
	select PXA25x
	select BOARD_IRQ_MAP_BIG
	help
	  Enable this if you plan to boot the kernel on Dell Axim X5 PDAs.
	  You also must enable MediaQ SoC driver (found under Misc devices->
	  SoC drivers), WM97XX AC97 codec driver (under Sound/OSS) and
	  PXA2XX PCMCIA support in order to get all Axim-specific
	  drivers in the submenu.

config AXIMX5_MISC
	tristate "Dell Axim X5 misc device support"
	depends on ARCH_AXIMX5
	help
	  This driver is a must for Dell Axim X5. It provides the MediaQ 1132
	  platform device, handles cradle, IrDA and USB Device Controller.
	  It is separated into a module to make kernels meant to run on a
	  bunch of different PDAs thinner, but in fact is a very basic driver.

config AXIMX5_LCD
	tristate "Dell Axim X5 MediaQ 1132 LCD"
	depends on ARCH_AXIMX5 && LCD_CLASS_DEVICE
	help
	  This driver provides support for changing power, brightness
	  and contrast on Dell Axim LCD display.

config AXIMX5_BACKLIGHT
	tristate "Dell Axim X5 Backlight"
	depends on ARCH_AXIMX5 && BACKLIGHT_CORGI

config AXIMX5_PCMCIA
	tristate "Dell Axim X5 PCMCIA"
	depends on ARCH_AXIMX5 && SOC_MQ11XX
	help
	  This enables support for using PCMCIA (CompactFlash) cards
	  on Dell Axim. You will also need to enable PXA2xx PCMCIA
	  support in the PCMCIA/Cardbus support menu.

config AXIMX5_AC97
	tristate "Dell Axim X5 AC97 controller"
	depends on ARCH_AXIMX5 && SOUND_WM97XX
	help
	  Select this if you're going to use the AC97 controller on
	  Dell Axim (most likely you want it). This includes audio,
	  battery monitor and touchscreen. You will also need to
	  enable the respective drivers in the Sound menu -
	  "PXA AC97 audio" and "WM97xx codec" for proper
	  touchscreen and battery support.

config AXIMX5_BUTTONS
	tristate "Dell Axim X5 buttons driver"
	depends on ARCH_AXIMX5 && INPUT
	help
	  This driver translates Dell Axim button presses to Linux input
	  subsystem events.
```

## arch/arm/mach-pxa/aximx50/Kconfig
```kconfig
menuconfig MACH_X50
	bool "Dell Axim X50/X51(v)"
	select PXA27x
	select KEYBOARD_GPIO
	help
	  Enable this if you plan to boot the kernel on the Dell Axim X50/X51(v)
	  series of PDAs. Currently there is only basic support for this
	  type of PDAs.

config X50_VGA
    bool "Dell Axim X50 series VGA display"
    depends on MACH_X50
    default true
    help
      Set this if you have the "v" variant of the DELL Axim X50 series.

config X50_BUTTONS
	tristate "X50/X51(v) buttons support"
	depends on MACH_X50
	select KEYBOARD_PXA27x
	help
	  X50/X51(v) buttons support.

config X50_TS
	tristate "ADS7846 / TSC2046 touchscreen support"
	depends on MACH_X50
	select TOUCHSCREEN_ADC
	help
	  X50/X51(v) touchscreen support.

config DRAM_BASE
	hex '(S)DRAM Base Address'
	depends on MACH_X50
	default 0xa8000000
	help
	  On the Dell Axim X50/X51(v), RAM starts at 0xa8000000. You should not 
          need to modify this value.
```

## arch/arm/mach-pxa/eseries/Kconfig
```kconfig
config TOSHIBA_TMIO_OHCI
	bool
	default n

menuconfig ARCH_ESERIES
	bool "Toshiba e7xx / e8xx"
	select BOARD_IRQ_MAP_BIG
	select DMABOUNCE
	select USB_ARCH_HAS_OHCI
	select TOSHIBA_TMIO_OHCI

config MACH_E330
	bool "Toahiba e330"
	default y
	select PXA25x
	depends on ARCH_ESERIES

config MACH_E740
        bool "Toshiba e740"
	default y
        select PXA25x
	depends on ARCH_ESERIES

config MACH_E750
        bool "Toshiba e750"
	default y
        select PXA25x
	depends on ARCH_ESERIES

config MACH_E400
	bool "Toshiba e400"
	default y
	select PXA25x
	depends on ARCH_ESERIES

config MACH_E800
        bool "Toshiba e800"
	default y
        select PXA25x
	depends on ARCH_ESERIES

config E330_LCD
	tristate "E330 LCD support"
	default y
	depends on ARCH_ESERIES

config E740_LCD
	tristate "E740 LCD support"
	default y
	depends on ARCH_ESERIES && BACKLIGHT_CLASS_DEVICE && LCD_CLASS_DEVICE && FB_W100

config E750_LCD
	tristate "E750 LCD support"
	default y
	depends on ARCH_ESERIES

config E400_LCD
	tristate "E400 LCD support"
	default y
	depends on ARCH_ESERIES && FB_PXA

config E800_LCD
	tristate "E800 LCD support"
	default y
	depends on ARCH_ESERIES && FB_W100

config TMIO_OHCI
	bool "TMIO OHCI support"
	default y
	depends on USB_OHCI_HCD && ARCH_ESERIES

config ESERIES_UDC
	tristate "USB Gadget support"
	default y
	depends on ARCH_ESERIES && (MACH_E740 || MACH_E750 || MACH_E400 || MACH_E800)
	help
	  Choose this option to allow your PDA to act as a USB device.
	  This driver supports the e740, e750, e400 and e800.

config E330_TC6387XB
	tristate "E330 TC6387XB platform support"
	default y
	depends on ARCH_ESERIES && MACH_E330
config E740_T7L66XB
	tristate "E740 T7L66XB platform support"
	default y
	depends on ARCH_ESERIES && MACH_E740

config E400_T7L66XB
	tristate "E400 T7L66XB platform support"
	default y
	depends on ARCH_ESERIES && MACH_E400

config E750_E800_TC6393XB
	tristate "E750 and E800 TC6393XB platform support"
	default y
	depends on ARCH_ESERIES && (MACH_E750 || MACH_E800)

config E740_PCMCIA
	tristate "E740 PCMCIA support"
	default y
	depends on ARCH_ESERIES && MACH_E740 && PCMCIA_PXA2XX
	help
	  Choose this option to allow your PDA to access its CF and WiFi
          devices.

config E750_PCMCIA
	tristate "E750 PCMCIA support"
	default y
	depends on ARCH_ESERIES && MACH_E750 && PCMCIA_PXA2XX
	help
	  Choose this option to allow your PDA to access its CF slot.

config E800_PCMCIA
	tristate "E800 PCMCIA support"
	default y
	depends on ARCH_ESERIES && MACH_E800 && PCMCIA_PXA2XX
	help
	  Choose this option to allow your PDA to access its CF and WiFi
	  devices.
```

## arch/arm/mach-pxa/h1900/Kconfig
```kconfig
menuconfig ARCH_H1900
	bool "HP iPAQ h1910/h1915"
	depends on ARCH_PXA
	select PXA25x
	select BOARD_IRQ_MAP_BIG

config IPAQ_H1900_LCD
	tristate "HP iPAQ h1910/h1915 LCD and Backlight low level driver"
	depends on ARCH_H1900 && LCD_CLASS_DEVICE && FB_PXA

config IPAQ_H1900_BUTTONS
	tristate "HP iPAQ h1910/h1915 Buttons"
	depends on ARCH_H1900
```

## arch/arm/mach-pxa/h2200/Kconfig
```kconfig
menuconfig ARCH_H2200
	bool "HP iPAQ h2200"
	select PXA25x
	select BOARD_IRQ_MAP_BIG
	select KEYBOARD_GPIO
	select PXA25x_ALTERNATE_FREQS
	help
	  This enables support for HP iPAQ H22xx series of handhelds.
	  There are a number of H22xx-specific drivers under this submenu:
	  pcmcia, lcd, battery, touchscreen
```

## arch/arm/mach-pxa/h3900/Kconfig
```kconfig
menuconfig MACH_H3900
        bool "HP iPAQ h3900"
        depends on ARCH_PXA
        select PXA25x
	select BOARD_IRQ_MAP_BIG
        select INPUT_KEYBOARD
        select KEYBOARD_ASIC2
        select KEYBOARD_GPIO

config IPAQ_H3900_LCD
	tristate "HP iPAQ h3900 LCD"
	depends on MACH_H3900 && HTC_ASIC2 && HTC_ASIC3 && LCD_CLASS_DEVICE && FB_PXA

config IPAQ_H3900_BACKLIGHT
        bool "LCD Backlight support"
        depends on MACH_H3900 && HTC_ASIC2 && HTC_ASIC3 && BACKLIGHT_CLASS_DEVICE

config IPAQ_H3900_BATTERY
	tristate "HP iPAQ h3900 battery"
	depends on MACH_H3900 && HTC_ASIC3
```
