## arch/arm/mach-pxa/palmtt3/Kconfig
```kconfig
menuconfig MACH_T3XSCALE
	bool "Palm Tungsten|T3"
	select PXA25x
	help
	  This enables support for Palm Tungsten|T3 handheld.

config PALMTT3_DISABLE_BORDER
	bool "Disable display border"
	depends on MACH_T3XSCALE
	help
	  Some displays can disable white border. This could allow it.
	  This makes screen bigger for 4 pixels in both directions.

config PALMTT3_BUTTONS
	tristate "Buttons support"
	depends on MACH_T3XSCALE
	help
	  Adds support for Palm T|T3 buttons and navpad.

config PALMTT3_BATTERY
	tristate "Battery monitoring support"
	depends on MACH_T3XSCALE && TPS65010 && SOC_TSC2101
	help
	  Adds battery driver support

config PALMTT3_BLUETOOTH
	tristate "Bluetooth support for Palm Tungsten|T3"
	depends on MACH_T3XSCALE && BT && TPS65010 && BT_BCM2035UART
	default m if TPS65010=m && BT_BCM2035UART=m
	default y if TPS65010=y || BT_BCM2035UART=y
	help
	  Adds bluetooth support for Palm Tungsten|T3

config PALMTT3_FBKEYBOARD
	bool "On-screen keyboard (BROKEN)"
	depends on PALMTT3_TSC2101
	help
	  On-screen framebuffer keyboard
```

## arch/arm/mach-pxa/palmtt5/Kconfig
```kconfig
menuconfig MACH_XSCALE_PALMTT5
	bool "Palm Tungsten|T5"
	select PXA27x
	help
	  This enables support for Palm Tungsten|T5 handheld.

config PALMTT5_DISABLE_BORDER
	bool "Disable display border"
	depends on MACH_XSCALE_PALMTT5
	help
	  Some displays can disable white border. This could allow it.
	  This makes screen bigger for 4 pixels in both directions.


config  PALMTT5_PM
        tristate "Palm Tungsten|T5 Power Management support"
	depends on MACH_XSCALE_PALMTT5
	default y if MACH_PALMTT5
	help
	    Enable support for suspend/resume the Palm Tungsten|T5 PDA.
```

## arch/arm/mach-pxa/palmtx/Kconfig
```kconfig
menuconfig MACH_XSCALE_PALMTX
	bool "Palm TX"
	select PXA27x
	help
	  This enables support for Palm TX handheld.

config  PALMTX_DEBUG
	bool "Debug output for Palm TX"
	depends on MACH_XSCALE_PALMTX
	default n 
	help
	  Enable core debug output for Palm TX modules.
	  
config  PALMTX_PM
        tristate "Palm TX Power Management support"
	depends on MACH_XSCALE_PALMTX
	default y if MACH_PALMTX
	help
	    Enable support for suspend/resume the Palm TX PDA.

config PALMTX_DISABLE_BORDER
	bool "Disable display border"
	depends on MACH_XSCALE_PALMTX
	help
	  Some displays can disable white border. This could allow it.
	  This makes screen bigger for 4 pixels in both directions.

config  PALMTX_PCMCIA
        tristate "Palm TX PCMCIA driver"
        depends on MACH_XSCALE_PALMTX
        help
            This driver handles the CF/PCCARD/PCMCIA bus.
```

## arch/arm/mach-pxa/palmz31/Kconfig
```kconfig
menuconfig MACH_ZIRE31
	bool "Palm Zire 31" 
	select PXA25x
	help
	Say Y here if you are going to run this kernel on a Palm Zire 31.

config PALMZ31_BUTTONS
        tristate "Palm Zire 31 buttons driver"
        depends on MACH_ZIRE31
	default y
	help
		This driver translates button presses on a Palm 
		Tungsten E2 to Linux input subsystem events.


config GPIOED
       tristate "GPIOED"
       depends on MACH_ZIRE31
       default n
       help
    	    Gpioed: only for debuging and testing!


config GPIOEDNG
       tristate "GPIOEDNG"
       depends on MACH_ZIRE31
       default n
       help
    	    Gpioed-ng: only for debuging and testing!
```

## arch/arm/mach-pxa/palmz72/Kconfig
```kconfig
menuconfig MACH_PALMZ72
	bool "Palm Zire 72"
	select PXA27x
	select KEYBOARD_PXA27x
	help
	  This enables support for PalmOne Zire 72 handheld.

config  PALMZ72_PM
        tristate "Palm Zire 72 Power Management support"
	depends on MACH_PALMZ72
	default y if MACH_PALMZ72
	help
	    Enable support for suspend/resume the PalmOne Zire 72 PDA.
```

## arch/arm/mach-pxa/plat-recon/Kconfig
```kconfig
menuconfig MACH_RECON
	bool "TDS Recon"
	select PXA25x
	help
	    This selection enables support for the TDS Recon.

config RECON_X
	bool "TDS Recon X"
	depends MACH_RECON
	help
	    This selection enables support for the TDS Recon X.
```

## arch/arm/mach-pxa/rover/Kconfig
```kconfig
menuconfig ARCH_ROVERP1
	bool "RoverP1 (Mitac Mio 336)"
	select PXA25x
	select BOARD_IRQ_MAP_BIG
	help
	  Enable this if you plan to boot the kernel on the Rover P1 (Mitac Mio 336) machine.	

config ROVERP1_LCD
	tristate "RoverP1 (Mitac Mio336) frame buffer LCD"
	depends on ARCH_ROVERP1 && BACKLIGHT_CLASS_DEVICE && LCD_CLASS_DEVICE && FB_PXA
        help
          LCD support for RoverP1 (Mitac Mio336) device.
	
menuconfig ARCH_ROVERP5P
	bool "RoverP5+"
	select PXA25x
	select BOARD_IRQ_MAP_BIG
	help
	  Enable this if you plan to boot the kernel on the Rover P5+ machine.
	
config ROVERP5P_LCD
	tristate "Rover P5+ MediaQ 1188 LCD"
	depends on ARCH_ROVERP5P && LCD_CLASS_DEVICE
	help
	  This driver provides support for changing power, brightness
	  and contrast on Rover P5+ LCD display.

config ROVERP5P_PCMCIA
	tristate "Rover P5+ PCMCIA"
	depends on ARCH_ROVERP5P
	help
	  This enables support for using PCMCIA (CompactFlash) cards
	  on Rover P5+. You will also need to enable PXA2xx PCMCIA
	  support in the PCMCIA/Cardbus support menu.
```

## arch/arm/mach-s3c2440/rx3000/Kconfig
```kconfig
config RX3000_BACKLIGHT
        tristate "Backlight driver for the HP iPAQ RX3000"
        depends MACH_RX3715 && BACKLIGHT_S3C2410 && HTC_ASIC3
        help
          Backlight driver for HP iPAQ RX3000.

config RX3000_LEDS
        tristate "LED driver for the HP iPAQ RX3000"
        depends MACH_RX3715 && LEDS_ASIC3
        help
          This option enables support for the LEDs on HP iPAQ RX3000.

config RX3000_BATTERY
	tristate "Battery monitor for HP iPAQ RX3000"
	depends on MACH_RX3715 && BATTERY_DS2760 && PDA_POWER
	help
	  Say Y here to enables support for HP iPAQ RX3000 series
	  battery control.
                                            
config RX3000_BLUETOOTH
        tristate "Bluetooth driver for the HP iPAQ RX3000"
        depends on MACH_RX3715 && RX3000_LEDS
        help
          Bluetooth driver for HP iPAQ RX3000.

config RX3000_BUTTONS
        tristate "Buttons driver for the HP iPAQ RX3000"
        depends on MACH_RX3715 && KEYBOARD_GPIO && KEYBOARD_ASIC3
        help
          Buttons driver for HP iPAQ RX3000.

config RX3000_SERIAL
        tristate "Serial port driver for the HP iPAQ RX3000"
        depends on MACH_RX3715 && HTC_ASIC3
        help
          Serial port driver for HP iPAQ RX3000.

config RX3000_TS
        tristate "Touchscreen driver for the HP iPAQ RX3000"
        depends MACH_RX3715 && TOUCHSCREEN_S3C2410
        help
          Touchscreen driver for HP iPAQ RX3000.

config RX3000_UDC
        tristate "USB Device controler driver for the HP iPAQ RX3000"
        depends MACH_RX3715 && USB_GADGET_S3C2410 && HTC_ASIC3
        help
          USB Device controler driver for HP iPAQ RX3000.
```

## arch/arm/mach-s3c2442/htchermes/Kconfig
```kconfig
config MACH_HTCHERMES
	bool "HTC Hermes aka TyTN"
	select CPU_S3C2440
	select CPU_S3C2442
	help
	  Say Y here if you are using the HTC Hermes.

	  See <http://wiki.xda-developers.com/index.php?pagename=Hermes_Linux> for more
	  information on this project

config HTCHERMES_LCD
	tristate "HTC Hermes VSFB LCD support"
	depends on MACH_HTCHERMES && LCD_CLASS_DEVICE
	help
	  This driver provides support for HTC Hermes LCD display.
```
