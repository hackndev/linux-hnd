## arch/arm/mach-pxa/htcapache/Kconfig
```kconfig
menuconfig MACH_HTCAPACHE
	bool "HTC Apache"
	select PXA27x
	select BOARD_IRQ_MAP_SMALL
        select KEYBOARD_GPIO
        select KEYBOARD_PXA27x
        select PXA_SSP
        select NEW_LEDS
        select LEDS_CLASS
        select ADC
        select HTC_EGPIO
	help
		Say Y here if you intend to run this kernel on a
		HTC Apache. Currently there is only basic support
		for this PDA.
```

## arch/arm/mach-pxa/htcathena/Kconfig
```kconfig
menuconfig MACH_HTCATHENA
	bool "HTC Athena"
	select PXA27x
	select PXA_SSP
	help
		Say Y here if you intend to run this kernel on a
		HTC Athena. Currently there is only basic support
		for this phone.

config HTCATHENA_CPLD1
	tristate "HTC Athena CPLD1 driver"
	depends on MACH_HTCATHENA
	help
	  This driver is supposed to test the Athena's CPLD1.

config HTCATHENA_CPLD2
	tristate "HTC Athena CPLD2 driver"
	depends on MACH_HTCATHENA
	help
	  This driver is supposed to test the Athena's CPLD2.


#config HTCATHENA_PHONE
#	tristate "HTC Alpine Phone driver"
#	depends on MACH_HTCATHENA
#	help
#	  Experimental driver for the Athena's MSM6275 UMTS chipset.

config HTCATHENA_VSFB
	tristate "HTC Athena VSFB LCD support"
	depends on MACH_HTCATHENA && LCD_CLASS_DEVICE
	help
	  This driver provides primitive support for HTC Athena LCD display.
```

## arch/arm/mach-pxa/htcbeetles/Kconfig
```kconfig
menuconfig MACH_HTCBEETLES
	bool "HTC Beetles (hPaq hw65xx)"
	select PXA27x
	select BOARD_IRQ_MAP_BIG
	help
		Say Y here if you intend to run this kernel on a
		HTC Beetles (iPAQ hw651x). Currently there is only basic support
		for this PDA.

config HTCBEETLES_TS
	tristate "Beetles TS driver (BROKEN, DEPRECATED, use ts-adc instead)"
	depends on MACH_HTCBEETLES
	help
	  BROKEN, DEPRECATED, use ts-adc instead
```

## arch/arm/mach-pxa/htcblueangel/Kconfig
```kconfig
menuconfig MACH_BLUEANGEL
        bool "HTC Blueangel"
        depends on ARCH_PXA
        select PXA25x
        select PXA26x
	select BOARD_IRQ_MAP_BIG
        select PXA_SSP
	select HTC_ASIC3
	select TOUCHSCREEN_TSC2200
	select KEYBOARD_TSC2200

config MACH_BLUEANGEL_LCD
	tristate "HTC Blueangel LCD support"
	depends on MACH_BLUEANGEL && HTC_ASIC3

config MACH_BLUEANGEL_BACKLIGHT
	bool "HTC Blueangel Backlight support"
	depends on MACH_BLUEANGEL && HTC_ASIC3

config MACH_BLUEANGEL_DS1WM
	tristate "HTC Blueangel ds1wm on HTC AIC2 (PASIC2) support"
	depends on MACH_BLUEANGEL
	---help---
	Provide ds1wm controller interface (needed for battery)
	
config MACH_BLUEANGEL_PCMCIA
	tristate "HTC Blueangel PCMCIA support"
	depends on MACH_BLUEANGEL
	---help---
	Required for wireless lan

config MACH_BLUEANGEL_SUSPEND
	tristate "HTC Blueangel suspend support"
	depends on MACH_BLUEANGEL
	---help---

config MACH_BLUEANGEL_LEDS
	tristate "HTC Blueangel LED support"
	depends on MACH_BLUEANGEL
	---help---
	Support for left led (wifi+bt)
	Off/on hook keys ilumination
	Keyboard ilumination
	Vibra on/off

config MACH_BLUEANGEL_ASIC3_LEDS
	tristate "HTC Blueangel ASIC3 LED support"
	depends on MACH_BLUEANGEL
	select LEDS_ASIC3
	---help---
	Support for right led (red+green+(=yellow))
	Off/on hook keys ilumination
	Keyboard ilumination
	Phone key ilumination
	Vibra on/off

config MACH_BLUEANGEL_KEYPAD
	tristate "HTC Blueangel keypad support"
	depends on MACH_BLUEANGEL
	---help---
	Support for function keys and pull-out keyboard

config MACH_BLUEANGEL_POWER
	tristate "HTC Blueangel battery support"
	depends on MACH_BLUEANGEL
	---help---

config MACH_BLUEANGEL_ROM
	tristate "HTC Blueangel flash rom support"
	depends on MACH_BLUEANGEL
	---help---
	Read and write (was never tested!) support of the pxa flash rom

config MACH_BLUEANGEL_DPRAM
	tristate "HTC Blueangel dpram asic support"
	depends on MACH_BLUEANGEL
	---help---
	Required for using data transfer via GPRS, CSD and FAX

config MACH_BLUEANGEL_PHONE
	tristate "HTC Blueangel Phone"
	depends on MACH_BLUEANGEL
	help
	  Enables support for TI Calypso Phone Module
```

## arch/arm/mach-pxa/htchimalaya/Kconfig
```kconfig
menuconfig MACH_HIMALAYA
        bool "HTC Himalaya"
        depends on ARCH_PXA
        select PXA25x
        select PXA26x
	select BOARD_IRQ_MAP_BIG

config MACH_HIMALAYA_ASIC3
	tristate "HTC Himalaya ASIC3 support"
	depends on MACH_HIMALAYA
	help
	  LCD Screen enable on HTC Himalaya.  

config MACH_HIMALAYA_LCD
	tristate "HTC Himalaya LCD support"
	depends on MACH_HIMALAYA_ASIC3 && MACH_HIMALAYA
	help
	  LCD Screen enable on HTC Himalaya.  

config MACH_HIMALAYA_UDC
	tristate "HTC Himalaya UDC support"
	depends on MACH_HIMALAYA_ASIC3 && MACH_HIMALAYA
	help
	  Module to handle USB client enable and disable.

config MACH_HIMALAYA_ROM
	tristate "HTC Himalaya flash rom support"
	depends on MACH_HIMALAYA
	---help---
	Read and write (be careful!) support of the pxa flash rom

config HIMALAYA_KP
	tristate "HTC Himalaya Keypad (TI TSC2200, ASIC3)"
	depends on HTC_ASIC3 && MACH_HIMALAYA && TSC2200 && INPUT && HIMALAYA_INPUT
	help
	  Module to handle HTC Himalaya buttons.

config HIMALAYA_LEDS
	tristate "HTC Himalaya LEDs"
	depends on HTC_ASIC3 && MACH_HIMALAYA
	help
	  Module to handle colour LEDs on and off (via the ASIC3 chip).
```

## arch/arm/mach-pxa/htcsable/Kconfig
```kconfig
menuconfig HTC_HW6X00
	bool "HTC Beetles/Sable (hPaq hw65xx/hw69xx)"
	select PXA27x
	select BOARD_IRQ_MAP_BIG
	select KEYBOARD_GPIO
	select KEYBOARD_PXA27x
	help
		Say Y here if you intend to run this kernel on a
		HTC Beetles or Sable (iPAQ hw651x or hw691x). 
		Currently there is only basic support for this PDA.

config MACH_HTCBEETLES
	bool "HTC Beetles (hPaq hw65xx)"
	depends on HTC_HW6X00
	select PXA27x
	select BOARD_IRQ_MAP_BIG
	select KEYBOARD_GPIO
	select KEYBOARD_PXA27x
	help
		HTC Beetles (iPAQ hw651x) support.

config MACH_HW6900
	bool "HTC Sable (hPaq hw69xx)"
	depends on HTC_HW6X00
	select PXA27x
	select BOARD_IRQ_MAP_BIG
	select KEYBOARD_GPIO
	select KEYBOARD_PXA27x
	help
		HTC Sable (iPAQ hw691x) support.

config HTCSABLE_LCD
	tristate "HTC Beetles/Sable LCD"
	depends on HTC_HW6X00 && ( MACH_HW6900 || MACH_HTCBEETLES ) && HTC_ASIC3 && LCD_CLASS_DEVICE
	help
		This driver provides support for changing power and brightness
		on HTC Sable LCD display.


config HTCSABLE_BACKLIGHT
	bool "HTC Beetles/Sable Backlight"
	depends on HTC_HW6X00 && ( MACH_HW6900 || MACH_HTCBEETLES ) && HTC_ASIC3 && BACKLIGHT_CLASS_DEVICE
	help
		This driver provides support for changing power and brightness
		on HTC Sable LCD backlight.

config HTCSABLE_ROM
	bool "HTC Beetles/Sable ROM"
	depends on HTC_HW6X00 && ( MACH_HW6900 || MACH_HTCBEETLES ) && HTC_ASIC3 && MTD
	help
		This driver provides access to devices' ROM
		(where IPL bootloader) is stored.

config HTCSABLE_BT
	bool "HTC Beetles/Sable Bluetooth"
	depends on HTC_HW6X00 && ( MACH_HW6900 || MACH_HTCBEETLES ) && HTC_ASIC3 && BT
	help
		This driver provides support for Bluetooth module.

config HTCSABLE_PHONE
	bool "HTC Beetles/Sable Phone"
	depends on HTC_HW6X00 && ( MACH_HW6900 || MACH_HTCBEETLES ) && HTC_ASIC3
	help
		This driver provides support for Phone module.
```

## arch/arm/mach-pxa/htcuniversal/Kconfig
```kconfig
menuconfig MACH_HTCUNIVERSAL
	bool "HTC Universal"
	select PXA27x
	select BOARD_IRQ_MAP_BIG
	help
		Say Y here if you intend to run this kernel on a
		HTC Universal. Currently there is only basic support
		for this PDA.

config HTCUNIVERSAL_CORE
        tristate "HTC Universal core"
        depends on MACH_HTCUNIVERSAL
        help
          This selection enables HTC Universal core support.

config HTCUNIVERSAL_UDC
        bool "USB Device Controller support"
        depends on MACH_HTCUNIVERSAL && HTC_ASIC3 && USB_PXA27X
        help
          Enables HTC Universal specific USB detection

config HTCUNIVERSAL_POWER
        tristate "HTC Universal power"
        depends on MACH_HTCUNIVERSAL && HTC_ASIC3
        help
          This selection enables HTC Universal power monitoring
	            hardware support (through ASIC3).

config HTCUNIVERSAL_BACKLIGHT
	bool "HTC Universal Backlight"
	depends on MACH_HTCUNIVERSAL && HTC_ASIC3 && BACKLIGHT_CLASS_DEVICE
	help
	  This driver provides support for changing power and brightness
	  on HTC Universal LCD backlight.

config HTCUNIVERSAL_LCD
	tristate "HTC Universal LCD"
	depends on MACH_HTCUNIVERSAL && HTC_ASIC3 && LCD_CLASS_DEVICE
	help
	  This driver provides support for changing power and brightness
	  on HTC Universal LCD display.

config HTCUNIVERSAL_TS2
	tristate "HTC Universal Touchscreen (old)"
	depends on MACH_HTCUNIVERSAL && HTC_ASIC3 
	help
	  Enable support for the HTC Universal Touchscreen Panel.

config HTCUNIVERSAL_BUTTONS
        tristate "HTC Universal buttons support"
        depends on MACH_HTCUNIVERSAL && HTC_ASIC3

config HTCUNIVERSAL_BLUETOOTH
	tristate "HTC Universal Bluetooth"
	depends on MACH_HTCUNIVERSAL && HTCUNIVERSAL_CORE && HTC_ASIC3
	help
	  Enables support for the TI BRF6150 Bluetooth Module
	  in the HTC Universal.

config HTCUNIVERSAL_ASIC3_LEDS
	tristate "HTC Universal ASIC3 LED support"
	select LEDS_ASIC3
	depends on MACH_HTCUNIVERSAL && HTCUNIVERSAL_CORE && HTC_ASIC3
	---help---
	Support for right (colors red+green+(amber)) and left (green+blue) led
	Off/on hook keys LED backlight
	Keyboard backlight
	Vibra
	Flashlight

config HTCUNIVERSAL_PHONE
	tristate "HTC Universal Phone"
	depends on MACH_HTCUNIVERSAL && HTCUNIVERSAL_CORE && HTC_ASIC3
	help
	  Enables support for the Qualcomm MSM6520 Phone Module
	  in the HTC Universal.

config HTCUNIVERSAL_AK4641
	depends on SND && I2C
	tristate
```

## arch/arm/mach-pxa/hx2750/Kconfig
```kconfig
menuconfig MACH_HX2750
	bool "HP iPAQ hx2750"
	select PXA27x
	select KEYBOARD_GPIO
	select SOC_TSC2101
	help
	  This enables support for the HP iPAQ HX2750 handheld.
	  
```

## arch/arm/mach-pxa/hx4700/Kconfig
```kconfig
menuconfig MACH_H4700
	bool "HP iPAQ hx4700"
	select PXA27x
	select BOARD_IRQ_MAP_BIG
	select INPUT_KEYBOARD
	select KEYBOARD_GPIO
	select IWMMXT
	select PXA_SUSPEND_SAVE_EXTRA_REGS
	help
	  This enables support for the HP iPAQ hx4700 handheld.
	  
config HX4700_NAVPOINT
	tristate "HP iPAQ hx4700 NavPoint"
	depends on MACH_H4700
	select INPUT_MOUSE
	select MOUSE_NAVPOINT
	help
	  This device enables support for iPAQ hx4700 NavPoint (tm)
	  navigation pointer (touchpad).

config HX4700_CORE
	tristate "HP iPAQ hx4700 Core"
	depends on MACH_H4700 && HTC_ASIC3
	help
	  This selection enables support for iPAQ hx4700 Core
	  Hardware support (ASIC3 and EGPIOs).

config HX4700_BLUETOOTH
	tristate "HP iPAQ hx4700 Bluetooth"
	depends on MACH_H4700 && HX4700_CORE
	help
	  Enables support for the TI BRF6150 Bluetooth Module
	  in the iPAQ hx4700.

config HX4700_PCMCIA
	tristate "HP iPAQ hx4700 PCMCIA"
	depends on MACH_H4700 && HX4700_CORE && PCMCIA_PXA2XX
	help
	  This enables support for using PCMCIA (CompactFlash) cards
	  on HP iPAQ hx4700. You will also need to enable PXA2xx PCMCIA
	  support in the PCMCIA/Cardbus support menu.

config HX4700_LCD
	tristate "HP iPAQ hx4700 LCD"
	depends on MACH_H4700
	select FB_W100
	help
	  This enables support for the ATI graphics chip on the hx4700.
	  You will also need to enable the W100FB framebuffer driver.

config HX4700_LEDS
	tristate "HP iPAQ hx4700 LEDs"
	depends on MACH_H4700
	select LEDS_ASIC3
	help
	  This enables support for HP iPAQ hx4700 color LED control
          (via the ASIC3 chip).

config HX4700_POWER2
	tristate "HP iPAQ hx4700 Power"
	depends on MACH_H4700
	help
	  This enables support for HP iPAQ hx4700 power (AC/USB).
```

## arch/arm/mach-pxa/magician/Kconfig
```kconfig
menuconfig MACH_MAGICIAN
	bool "HTC Magician"
	depends on ARCH_PXA
	select PXA27x
	select IWMMXT
	select BOARD_IRQ_MAP_SMALL
	select HTC_EGPIO
	help
	  This enables support for the HTC Magician handheld.

config MAGICIAN_PM
	tristate "HTC Magician power management"
	depends on MACH_MAGICIAN
	select PXA_SUSPEND_SAVE_EXTRA_REGS
	help
	  This selection enables HTC Magician power
	  management support.

config MAGICIAN_TS
	tristate "HTC Magician touchscreen"
	depends on MACH_MAGICIAN
	help
	  Enable support for the HTC Magician touchscreen panel.

config MAGICIAN_LCD
	tristate "HTC Magician LCD"
	depends on MACH_MAGICIAN
	help
	  This driver provides support for changing power and brightness
	  of the HTC Magician LCD display and backlight.

config MAGICIAN_PHONE
	tristate "HTC Magician Phone driver"
	depends on MACH_MAGICIAN
	help
	  Experimental driver for the Magician's GSM chipset connected
	  to BTUART(cmd) and FFUART(data).
```

## arch/arm/mach-pxa/palmld/Kconfig
```kconfig
menuconfig MACH_XSCALE_PALMLD
	bool "Palm LifeDrive"
	select PXA27x
	select KEYBOARD_PXA27x
	help
		Say Y here if you intend to run this kernel on a Palm 
		LifeDrive. Currently there is only basic support for 
		this PDA.

config PALMLD_PCMCIA
        tristate "Palm LifeDrive PCMCIA driver"
        depends on MACH_XSCALE_PALMLD
	help
		This driver handles the CF/PCCARD/PCMCIA bus which is not used to
		connect the microdrive.

config PALMLD_IDE
	tristate "Palm LifeDrive IDE driver"
	depends on MACH_XSCALE_PALMLD

config PALMLD_PM
	tristate "Palm LifeDrive Power Management support"
	depends on MACH_XSCALE_PALMLD
	default y if MACH_XSCALE_PALMLD
	help
		Enable support for suspend/resume the PalmOne LifeDrive PDA.
```

## arch/arm/mach-pxa/palmt650/Kconfig
```kconfig
menuconfig MACH_XSCALE_PALMTREO650
	bool "Palm Treo 650"
	select PXA27x
	select KEYBOARD_PXA27x
	help
		Say Y here if you intend to run this kernel on a
		Palm Treo 650. Currently there is only basic support
		for this PDA.

config PALMT650_GSM
	tristate "Palm Treo 650 GSM baseband processor"
	depends on MACH_XSCALE_PALMTREO650
	default y
	help
		This module provides support for controlling power to
		the GSM baseband processor in the Treo 650.  Say Y here
		if you are unsure.
```

## arch/arm/mach-pxa/palmt680/Kconfig
```kconfig
menuconfig MACH_XSCALE_TREO680
	bool "Palm Treo 680"
	select PXA27x
	select KEYBOARD_PXA27x
	help
		Say Y here if you intend to run this kernel on a
		Palm Treo 680. Currently there is only basic support
		for this PDA.

config PALMT680_GSM
	bool "Palm Treo 680 GSM support"
	depends on MACH_XSCALE_TREO680
	default y
	help
		This module provides support for controlling power to
		the GSM baseband processor in the Treo 680.  Say Y here
		if you are unsure.
```

## arch/arm/mach-pxa/palmt700wx/Kconfig
```kconfig
menuconfig MACH_T700WX
	bool "Palm Treo 700wx"
	select PXA27x
	help
		Say Y here if you intend to run this kernel on a
		Palm Treo 700wx. Currently there is only basic support
		for this PDA.
```

## arch/arm/mach-pxa/palmtc/Kconfig
```kconfig
menuconfig MACH_OMAP_PALMTC
	bool "Palm Tungsten C"
	select PXA25x
	help
	Say Y here if you intend to run this kernel on a
	Palm Tungsten C. Currently there is only basic support
	for this PDA.

config PALMTC_KEYBOARD
	tristate "Palm Tungsten C keyboard driver"
	depends on MACH_OMAP_PALMTC
	help
		This driver translates button presses on a Palm 
		Tungsten C to Linux input subsystem events

config PALMTC_UCB1400
        tristate "Palm Tungsten C ucb1400 support (touchscreen/battery/led/vibra)"
        depends on MACH_OMAP_PALMTC
	default y
	help
		This driver handles the UCB1400 AC97 codec,
		which enables touchscreen and battery-status
		on the device

config PALMTC_PCMCIA
	tristate "PALMTC PCMCIA"
	depends on MACH_OMAP_PALMTC
	help
		This enables support for PCMCIA/CF slot embedded
		in Palm Tungsten|C.
```

## arch/arm/mach-pxa/palmte2/Kconfig
```kconfig
menuconfig MACH_TUNGE2
	bool "Palm Tungsten E2"
	select PXA25x
	help
		This enables support for Palm Tungsten E2 handheld.
```
